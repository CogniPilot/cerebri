## build-native_sim/Kconfig/soc/Kconfig.soc
```kconfig
# Load SoC Kconfig descriptions.
osource "/home/jgoppert/cognipilot/ws/zephyr/soc/xlnx/zynqmp/Kconfig.soc"
osource "/home/jgoppert/cognipilot/ws/zephyr/soc/xlnx/zynq7000/Kconfig.soc"
osource "/home/jgoppert/cognipilot/ws/zephyr/soc/xlnx/versalnet/Kconfig.soc"
osource "/home/jgoppert/cognipilot/ws/zephyr/soc/xlnx/versal2/Kconfig.soc"
osource "/home/jgoppert/cognipilot/ws/zephyr/soc/xen/Kconfig.soc"
osource "/home/jgoppert/cognipilot/ws/zephyr/soc/wch/ch32v/Kconfig.soc"
osource "/home/jgoppert/cognipilot/ws/zephyr/soc/ti/simplelink/Kconfig.soc"
osource "/home/jgoppert/cognipilot/ws/zephyr/soc/ti/mspm0/Kconfig.soc"
osource "/home/jgoppert/cognipilot/ws/zephyr/soc/ti/lm3s6965/Kconfig.soc"
osource "/home/jgoppert/cognipilot/ws/zephyr/soc/ti/k3/Kconfig.soc"
osource "/home/jgoppert/cognipilot/ws/zephyr/soc/telink/tlsr/Kconfig.soc"
osource "/home/jgoppert/cognipilot/ws/zephyr/soc/starfive/jh71xx/Kconfig.soc"
osource "/home/jgoppert/cognipilot/ws/zephyr/soc/st/stm32/Kconfig.soc"
osource "/home/jgoppert/cognipilot/ws/zephyr/soc/snps/qemu_arc/Kconfig.soc"
osource "/home/jgoppert/cognipilot/ws/zephyr/soc/snps/nsim/arc_v/Kconfig.soc"
osource "/home/jgoppert/cognipilot/ws/zephyr/soc/snps/nsim/arc_classic/Kconfig.soc"
osource "/home/jgoppert/cognipilot/ws/zephyr/soc/snps/hsdk4xd/Kconfig.soc"
osource "/home/jgoppert/cognipilot/ws/zephyr/soc/snps/hsdk/Kconfig.soc"
osource "/home/jgoppert/cognipilot/ws/zephyr/soc/snps/emsk/Kconfig.soc"
osource "/home/jgoppert/cognipilot/ws/zephyr/soc/snps/emsdp/Kconfig.soc"
osource "/home/jgoppert/cognipilot/ws/zephyr/soc/snps/arc_iot/Kconfig.soc"
osource "/home/jgoppert/cognipilot/ws/zephyr/soc/silabs/Kconfig.soc"
osource "/home/jgoppert/cognipilot/ws/zephyr/soc/sifli/sf32/Kconfig.soc"
osource "/home/jgoppert/cognipilot/ws/zephyr/soc/sifive/sifive_freedom/Kconfig.soc"
osource "/home/jgoppert/cognipilot/ws/zephyr/soc/sensry/Kconfig.soc"
osource "/home/jgoppert/cognipilot/ws/zephyr/soc/rockchip/Kconfig.soc"
osource "/home/jgoppert/cognipilot/ws/zephyr/soc/renode/riscv_virtual/Kconfig.soc"
osource "/home/jgoppert/cognipilot/ws/zephyr/soc/renode/cortex_r8_virtual/Kconfig.soc"
osource "/home/jgoppert/cognipilot/ws/zephyr/soc/renesas/smartbond/Kconfig.soc"
osource "/home/jgoppert/cognipilot/ws/zephyr/soc/renesas/rz/Kconfig.soc"
osource "/home/jgoppert/cognipilot/ws/zephyr/soc/renesas/rx/Kconfig.soc"
osource "/home/jgoppert/cognipilot/ws/zephyr/soc/renesas/rcar/Kconfig.soc"
osource "/home/jgoppert/cognipilot/ws/zephyr/soc/renesas/ra/Kconfig.soc"
osource "/home/jgoppert/cognipilot/ws/zephyr/soc/realtek/ec/Kconfig.soc"
osource "/home/jgoppert/cognipilot/ws/zephyr/soc/raspberrypi/rpi_pico/Kconfig.soc"
osource "/home/jgoppert/cognipilot/ws/zephyr/soc/quicklogic/eos_s3/Kconfig.soc"
osource "/home/jgoppert/cognipilot/ws/zephyr/soc/qemu/virt_riscv/Kconfig.soc"
osource "/home/jgoppert/cognipilot/ws/zephyr/soc/qemu/malta/Kconfig.soc"
osource "/home/jgoppert/cognipilot/ws/zephyr/soc/openisa/rv32m1/Kconfig.soc"
osource "/home/jgoppert/cognipilot/ws/zephyr/soc/openhwgroup/cva6/Kconfig.soc"
osource "/home/jgoppert/cognipilot/ws/zephyr/soc/oct/osd32mp15x/Kconfig.soc"
osource "/home/jgoppert/cognipilot/ws/zephyr/soc/nxp/s32/Kconfig.soc"
osource "/home/jgoppert/cognipilot/ws/zephyr/soc/nxp/rw/Kconfig.soc"
osource "/home/jgoppert/cognipilot/ws/zephyr/soc/nxp/mcx/Kconfig.soc"
osource "/home/jgoppert/cognipilot/ws/zephyr/soc/nxp/lpc/Kconfig.soc"
osource "/home/jgoppert/cognipilot/ws/zephyr/soc/nxp/layerscape/Kconfig.soc"
osource "/home/jgoppert/cognipilot/ws/zephyr/soc/nxp/kinetis/Kconfig.soc"
osource "/home/jgoppert/cognipilot/ws/zephyr/soc/nxp/imxrt/Kconfig.soc"
osource "/home/jgoppert/cognipilot/ws/zephyr/soc/nxp/imx/Kconfig.soc"
osource "/home/jgoppert/cognipilot/ws/zephyr/soc/nuvoton/numicro/Kconfig.soc"
osource "/home/jgoppert/cognipilot/ws/zephyr/soc/nuvoton/numaker/Kconfig.soc"
osource "/home/jgoppert/cognipilot/ws/zephyr/soc/nuvoton/npcx/Kconfig.soc"
osource "/home/jgoppert/cognipilot/ws/zephyr/soc/nuvoton/npcm/Kconfig.soc"
osource "/home/jgoppert/cognipilot/ws/zephyr/soc/nordic/Kconfig.soc"
osource "/home/jgoppert/cognipilot/ws/zephyr/soc/neorv32/Kconfig.soc"
osource "/home/jgoppert/cognipilot/ws/zephyr/soc/native/inf_clock/Kconfig.soc"
osource "/home/jgoppert/cognipilot/ws/zephyr/soc/microchip/sam/Kconfig.soc"
osource "/home/jgoppert/cognipilot/ws/zephyr/soc/microchip/sam/sama7/Kconfig.soc"
osource "/home/jgoppert/cognipilot/ws/zephyr/soc/microchip/sam/sam_d5x_e5x/Kconfig.soc"
osource "/home/jgoppert/cognipilot/ws/zephyr/soc/microchip/pic32c/pic32cz_ca/Kconfig.soc"
osource "/home/jgoppert/cognipilot/ws/zephyr/soc/microchip/pic32c/pic32cx_sg/Kconfig.soc"
osource "/home/jgoppert/cognipilot/ws/zephyr/soc/microchip/pic32c/pic32cm_jh/Kconfig.soc"
osource "/home/jgoppert/cognipilot/ws/zephyr/soc/microchip/miv/Kconfig.soc"
osource "/home/jgoppert/cognipilot/ws/zephyr/soc/microchip/mec/Kconfig.soc"
osource "/home/jgoppert/cognipilot/ws/zephyr/soc/mediatek/mt8xxx/Kconfig.soc"
osource "/home/jgoppert/cognipilot/ws/zephyr/soc/lowrisc/opentitan/Kconfig.soc"
osource "/home/jgoppert/cognipilot/ws/zephyr/soc/litex/litex_vexriscv/Kconfig.soc"
osource "/home/jgoppert/cognipilot/ws/zephyr/soc/ite/ec/Kconfig.soc"
osource "/home/jgoppert/cognipilot/ws/zephyr/soc/intel/raptor_lake/Kconfig.soc"
osource "/home/jgoppert/cognipilot/ws/zephyr/soc/intel/panther_lake/Kconfig.soc"
osource "/home/jgoppert/cognipilot/ws/zephyr/soc/intel/lakemont/Kconfig.soc"
osource "/home/jgoppert/cognipilot/ws/zephyr/soc/intel/intel_socfpga_std/Kconfig.soc"
osource "/home/jgoppert/cognipilot/ws/zephyr/soc/intel/intel_socfpga/Kconfig.soc"
osource "/home/jgoppert/cognipilot/ws/zephyr/soc/intel/intel_niosv/Kconfig.soc"
osource "/home/jgoppert/cognipilot/ws/zephyr/soc/intel/intel_ish/Kconfig.soc"
osource "/home/jgoppert/cognipilot/ws/zephyr/soc/intel/intel_adsp/Kconfig.soc"
osource "/home/jgoppert/cognipilot/ws/zephyr/soc/intel/elkhart_lake/Kconfig.soc"
osource "/home/jgoppert/cognipilot/ws/zephyr/soc/intel/atom/Kconfig.soc"
osource "/home/jgoppert/cognipilot/ws/zephyr/soc/intel/apollo_lake/Kconfig.soc"
osource "/home/jgoppert/cognipilot/ws/zephyr/soc/intel/alder_lake/Kconfig.soc"
osource "/home/jgoppert/cognipilot/ws/zephyr/soc/infineon/edge/Kconfig.soc"
osource "/home/jgoppert/cognipilot/ws/zephyr/soc/infineon/cat3/Kconfig.soc"
osource "/home/jgoppert/cognipilot/ws/zephyr/soc/infineon/cat1c/Kconfig.soc"
osource "/home/jgoppert/cognipilot/ws/zephyr/soc/infineon/cat1b/Kconfig.soc"
osource "/home/jgoppert/cognipilot/ws/zephyr/soc/infineon/cat1a/Kconfig.soc"
osource "/home/jgoppert/cognipilot/ws/zephyr/soc/gd/gd32/Kconfig.soc"
osource "/home/jgoppert/cognipilot/ws/zephyr/soc/gaisler/leon3/Kconfig.soc"
osource "/home/jgoppert/cognipilot/ws/zephyr/soc/gaisler/gr716a/Kconfig.soc"
osource "/home/jgoppert/cognipilot/ws/zephyr/soc/espressif/Kconfig.soc"
osource "/home/jgoppert/cognipilot/ws/zephyr/soc/ene/kb1200/Kconfig.soc"
osource "/home/jgoppert/cognipilot/ws/zephyr/soc/ene/kb106x/Kconfig.soc"
osource "/home/jgoppert/cognipilot/ws/zephyr/soc/egis/Kconfig.soc"
osource "/home/jgoppert/cognipilot/ws/zephyr/soc/efinix/sapphire/Kconfig.soc"
osource "/home/jgoppert/cognipilot/ws/zephyr/soc/cdns/xtensa_sample_controller/Kconfig.soc"
osource "/home/jgoppert/cognipilot/ws/zephyr/soc/cdns/sample_controller32/Kconfig.soc"
osource "/home/jgoppert/cognipilot/ws/zephyr/soc/cdns/dc233c/Kconfig.soc"
osource "/home/jgoppert/cognipilot/ws/zephyr/soc/brcm/bcmvk/Kconfig.soc"
osource "/home/jgoppert/cognipilot/ws/zephyr/soc/brcm/bcm2712/Kconfig.soc"
osource "/home/jgoppert/cognipilot/ws/zephyr/soc/brcm/bcm2711/Kconfig.soc"
osource "/home/jgoppert/cognipilot/ws/zephyr/soc/bflb/Kconfig.soc"
osource "/home/jgoppert/cognipilot/ws/zephyr/soc/atmel/sam0/Kconfig.soc"
osource "/home/jgoppert/cognipilot/ws/zephyr/soc/atmel/sam/Kconfig.soc"
osource "/home/jgoppert/cognipilot/ws/zephyr/soc/aspeed/Kconfig.soc"
osource "/home/jgoppert/cognipilot/ws/zephyr/soc/arm/Kconfig.soc"
osource "/home/jgoppert/cognipilot/ws/zephyr/soc/arm/beetle/Kconfig.soc"
osource "/home/jgoppert/cognipilot/ws/zephyr/soc/antmicro/myra/Kconfig.soc"
osource "/home/jgoppert/cognipilot/ws/zephyr/soc/andestech/Kconfig.soc"
osource "/home/jgoppert/cognipilot/ws/zephyr/soc/amd/acp_6_0/Kconfig.soc"
osource "/home/jgoppert/cognipilot/ws/zephyr/soc/ambiq/Kconfig.soc"
osource "/home/jgoppert/cognipilot/ws/zephyr/soc/aesc/Kconfig.soc"
osource "/home/jgoppert/cognipilot/ws/zephyr/soc/adi/max32/Kconfig.soc"
```
