## build-native_sim/Kconfig/soc/Kconfig
```kconfig
# Load Zephyr SoC Kconfig descriptions.
osource "/home/jgoppert/cognipilot/ws/zephyr/soc/xlnx/zynqmp/Kconfig"
osource "/home/jgoppert/cognipilot/ws/zephyr/soc/xlnx/zynq7000/Kconfig"
osource "/home/jgoppert/cognipilot/ws/zephyr/soc/xlnx/versalnet/Kconfig"
osource "/home/jgoppert/cognipilot/ws/zephyr/soc/xlnx/versal2/Kconfig"
osource "/home/jgoppert/cognipilot/ws/zephyr/soc/xen/Kconfig"
osource "/home/jgoppert/cognipilot/ws/zephyr/soc/wch/ch32v/Kconfig"
osource "/home/jgoppert/cognipilot/ws/zephyr/soc/ti/simplelink/Kconfig"
osource "/home/jgoppert/cognipilot/ws/zephyr/soc/ti/mspm0/Kconfig"
osource "/home/jgoppert/cognipilot/ws/zephyr/soc/ti/lm3s6965/Kconfig"
osource "/home/jgoppert/cognipilot/ws/zephyr/soc/ti/k3/Kconfig"
osource "/home/jgoppert/cognipilot/ws/zephyr/soc/telink/tlsr/Kconfig"
osource "/home/jgoppert/cognipilot/ws/zephyr/soc/starfive/jh71xx/Kconfig"
osource "/home/jgoppert/cognipilot/ws/zephyr/soc/st/stm32/Kconfig"
osource "/home/jgoppert/cognipilot/ws/zephyr/soc/snps/qemu_arc/Kconfig"
osource "/home/jgoppert/cognipilot/ws/zephyr/soc/snps/nsim/arc_v/Kconfig"
osource "/home/jgoppert/cognipilot/ws/zephyr/soc/snps/nsim/arc_classic/Kconfig"
osource "/home/jgoppert/cognipilot/ws/zephyr/soc/snps/hsdk4xd/Kconfig"
osource "/home/jgoppert/cognipilot/ws/zephyr/soc/snps/hsdk/Kconfig"
osource "/home/jgoppert/cognipilot/ws/zephyr/soc/snps/emsk/Kconfig"
osource "/home/jgoppert/cognipilot/ws/zephyr/soc/snps/emsdp/Kconfig"
osource "/home/jgoppert/cognipilot/ws/zephyr/soc/snps/arc_iot/Kconfig"
osource "/home/jgoppert/cognipilot/ws/zephyr/soc/silabs/Kconfig"
osource "/home/jgoppert/cognipilot/ws/zephyr/soc/sifli/sf32/Kconfig"
osource "/home/jgoppert/cognipilot/ws/zephyr/soc/sifive/sifive_freedom/Kconfig"
osource "/home/jgoppert/cognipilot/ws/zephyr/soc/sensry/Kconfig"
osource "/home/jgoppert/cognipilot/ws/zephyr/soc/rockchip/Kconfig"
osource "/home/jgoppert/cognipilot/ws/zephyr/soc/renode/riscv_virtual/Kconfig"
osource "/home/jgoppert/cognipilot/ws/zephyr/soc/renode/cortex_r8_virtual/Kconfig"
osource "/home/jgoppert/cognipilot/ws/zephyr/soc/renesas/smartbond/Kconfig"
osource "/home/jgoppert/cognipilot/ws/zephyr/soc/renesas/rz/Kconfig"
osource "/home/jgoppert/cognipilot/ws/zephyr/soc/renesas/rx/Kconfig"
osource "/home/jgoppert/cognipilot/ws/zephyr/soc/renesas/rcar/Kconfig"
osource "/home/jgoppert/cognipilot/ws/zephyr/soc/renesas/ra/Kconfig"
osource "/home/jgoppert/cognipilot/ws/zephyr/soc/realtek/ec/Kconfig"
osource "/home/jgoppert/cognipilot/ws/zephyr/soc/raspberrypi/rpi_pico/Kconfig"
osource "/home/jgoppert/cognipilot/ws/zephyr/soc/quicklogic/eos_s3/Kconfig"
osource "/home/jgoppert/cognipilot/ws/zephyr/soc/qemu/virt_riscv/Kconfig"
osource "/home/jgoppert/cognipilot/ws/zephyr/soc/qemu/malta/Kconfig"
osource "/home/jgoppert/cognipilot/ws/zephyr/soc/openisa/rv32m1/Kconfig"
osource "/home/jgoppert/cognipilot/ws/zephyr/soc/openhwgroup/cva6/Kconfig"
osource "/home/jgoppert/cognipilot/ws/zephyr/soc/oct/osd32mp15x/Kconfig"
osource "/home/jgoppert/cognipilot/ws/zephyr/soc/nxp/s32/Kconfig"
osource "/home/jgoppert/cognipilot/ws/zephyr/soc/nxp/rw/Kconfig"
osource "/home/jgoppert/cognipilot/ws/zephyr/soc/nxp/mcx/Kconfig"
osource "/home/jgoppert/cognipilot/ws/zephyr/soc/nxp/lpc/Kconfig"
osource "/home/jgoppert/cognipilot/ws/zephyr/soc/nxp/layerscape/Kconfig"
osource "/home/jgoppert/cognipilot/ws/zephyr/soc/nxp/kinetis/Kconfig"
osource "/home/jgoppert/cognipilot/ws/zephyr/soc/nxp/imxrt/Kconfig"
osource "/home/jgoppert/cognipilot/ws/zephyr/soc/nxp/imx/Kconfig"
osource "/home/jgoppert/cognipilot/ws/zephyr/soc/nuvoton/numicro/Kconfig"
osource "/home/jgoppert/cognipilot/ws/zephyr/soc/nuvoton/numaker/Kconfig"
osource "/home/jgoppert/cognipilot/ws/zephyr/soc/nuvoton/npcx/Kconfig"
osource "/home/jgoppert/cognipilot/ws/zephyr/soc/nuvoton/npcm/Kconfig"
osource "/home/jgoppert/cognipilot/ws/zephyr/soc/nordic/Kconfig"
osource "/home/jgoppert/cognipilot/ws/zephyr/soc/neorv32/Kconfig"
osource "/home/jgoppert/cognipilot/ws/zephyr/soc/native/inf_clock/Kconfig"
osource "/home/jgoppert/cognipilot/ws/zephyr/soc/microchip/sam/Kconfig"
osource "/home/jgoppert/cognipilot/ws/zephyr/soc/microchip/sam/sama7/Kconfig"
osource "/home/jgoppert/cognipilot/ws/zephyr/soc/microchip/sam/sam_d5x_e5x/Kconfig"
osource "/home/jgoppert/cognipilot/ws/zephyr/soc/microchip/pic32c/pic32cz_ca/Kconfig"
osource "/home/jgoppert/cognipilot/ws/zephyr/soc/microchip/pic32c/pic32cx_sg/Kconfig"
osource "/home/jgoppert/cognipilot/ws/zephyr/soc/microchip/pic32c/pic32cm_jh/Kconfig"
osource "/home/jgoppert/cognipilot/ws/zephyr/soc/microchip/miv/Kconfig"
osource "/home/jgoppert/cognipilot/ws/zephyr/soc/microchip/mec/Kconfig"
osource "/home/jgoppert/cognipilot/ws/zephyr/soc/mediatek/mt8xxx/Kconfig"
osource "/home/jgoppert/cognipilot/ws/zephyr/soc/lowrisc/opentitan/Kconfig"
osource "/home/jgoppert/cognipilot/ws/zephyr/soc/litex/litex_vexriscv/Kconfig"
osource "/home/jgoppert/cognipilot/ws/zephyr/soc/ite/ec/Kconfig"
osource "/home/jgoppert/cognipilot/ws/zephyr/soc/intel/raptor_lake/Kconfig"
osource "/home/jgoppert/cognipilot/ws/zephyr/soc/intel/panther_lake/Kconfig"
osource "/home/jgoppert/cognipilot/ws/zephyr/soc/intel/lakemont/Kconfig"
osource "/home/jgoppert/cognipilot/ws/zephyr/soc/intel/intel_socfpga_std/Kconfig"
osource "/home/jgoppert/cognipilot/ws/zephyr/soc/intel/intel_socfpga/Kconfig"
osource "/home/jgoppert/cognipilot/ws/zephyr/soc/intel/intel_niosv/Kconfig"
osource "/home/jgoppert/cognipilot/ws/zephyr/soc/intel/intel_ish/Kconfig"
osource "/home/jgoppert/cognipilot/ws/zephyr/soc/intel/intel_adsp/Kconfig"
osource "/home/jgoppert/cognipilot/ws/zephyr/soc/intel/elkhart_lake/Kconfig"
osource "/home/jgoppert/cognipilot/ws/zephyr/soc/intel/atom/Kconfig"
osource "/home/jgoppert/cognipilot/ws/zephyr/soc/intel/apollo_lake/Kconfig"
osource "/home/jgoppert/cognipilot/ws/zephyr/soc/intel/alder_lake/Kconfig"
osource "/home/jgoppert/cognipilot/ws/zephyr/soc/infineon/edge/Kconfig"
osource "/home/jgoppert/cognipilot/ws/zephyr/soc/infineon/cat3/Kconfig"
osource "/home/jgoppert/cognipilot/ws/zephyr/soc/infineon/cat1c/Kconfig"
osource "/home/jgoppert/cognipilot/ws/zephyr/soc/infineon/cat1b/Kconfig"
osource "/home/jgoppert/cognipilot/ws/zephyr/soc/infineon/cat1a/Kconfig"
osource "/home/jgoppert/cognipilot/ws/zephyr/soc/gd/gd32/Kconfig"
osource "/home/jgoppert/cognipilot/ws/zephyr/soc/gaisler/leon3/Kconfig"
osource "/home/jgoppert/cognipilot/ws/zephyr/soc/gaisler/gr716a/Kconfig"
osource "/home/jgoppert/cognipilot/ws/zephyr/soc/espressif/Kconfig"
osource "/home/jgoppert/cognipilot/ws/zephyr/soc/ene/kb1200/Kconfig"
osource "/home/jgoppert/cognipilot/ws/zephyr/soc/ene/kb106x/Kconfig"
osource "/home/jgoppert/cognipilot/ws/zephyr/soc/egis/Kconfig"
osource "/home/jgoppert/cognipilot/ws/zephyr/soc/efinix/sapphire/Kconfig"
osource "/home/jgoppert/cognipilot/ws/zephyr/soc/cdns/xtensa_sample_controller/Kconfig"
osource "/home/jgoppert/cognipilot/ws/zephyr/soc/cdns/sample_controller32/Kconfig"
osource "/home/jgoppert/cognipilot/ws/zephyr/soc/cdns/dc233c/Kconfig"
osource "/home/jgoppert/cognipilot/ws/zephyr/soc/brcm/bcmvk/Kconfig"
osource "/home/jgoppert/cognipilot/ws/zephyr/soc/brcm/bcm2712/Kconfig"
osource "/home/jgoppert/cognipilot/ws/zephyr/soc/brcm/bcm2711/Kconfig"
osource "/home/jgoppert/cognipilot/ws/zephyr/soc/bflb/Kconfig"
osource "/home/jgoppert/cognipilot/ws/zephyr/soc/atmel/sam0/Kconfig"
osource "/home/jgoppert/cognipilot/ws/zephyr/soc/atmel/sam/Kconfig"
osource "/home/jgoppert/cognipilot/ws/zephyr/soc/aspeed/Kconfig"
osource "/home/jgoppert/cognipilot/ws/zephyr/soc/arm/Kconfig"
osource "/home/jgoppert/cognipilot/ws/zephyr/soc/arm/beetle/Kconfig"
osource "/home/jgoppert/cognipilot/ws/zephyr/soc/antmicro/myra/Kconfig"
osource "/home/jgoppert/cognipilot/ws/zephyr/soc/andestech/Kconfig"
osource "/home/jgoppert/cognipilot/ws/zephyr/soc/amd/acp_6_0/Kconfig"
osource "/home/jgoppert/cognipilot/ws/zephyr/soc/ambiq/Kconfig"
osource "/home/jgoppert/cognipilot/ws/zephyr/soc/aesc/Kconfig"
osource "/home/jgoppert/cognipilot/ws/zephyr/soc/adi/max32/Kconfig"
```
