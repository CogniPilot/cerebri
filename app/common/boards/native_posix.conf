## app/common/boards/native_posix.conf
```kconfig
CONFIG_ETH_NATIVE_POSIX=y
CONFIG_TEST_RANDOM_GENERATOR=y
CONFIG_SYS_CLOCK_TICKS_PER_SEC=1000
CONFIG_NATIVE_POSIX_SLOWDOWN_TO_REAL_TIME=n

CONFIG_UART_NATIVE_POSIX_PORT_1_ENABLE=n

CONFIG_DREAM_SITL=y
CONFIG_SYNAPSE_ETHERNET=y
CONFIG_SYNAPSE_UART=n

CONFIG_NEWLIB_LIBC=n
CONFIG_EXTERNAL_LIBC=y
CONFIG_POSIX_API=n
CONFIG_POSIX_CLOCK=n

# SNTP disabled, use sim time
CONFIG_SNTP=n
CONFIG_NET_CONFIG_CLOCK_SNTP_INIT=n
CONFIG_NET_CONFIG_SNTP_INIT_SERVER=""
```

## app/elm4/boards/vmu_rt1170_mimxrt1176_cm7.conf
```kconfig
CONFIG_CEREBRI_DREAM_SIL=n
CONFIG_CEREBRI_ACTUATE_PWM=n
CONFIG_CEREBRI_SENSE_POWER=y
CONFIG_CEREBRI_SENSE_UBX_GNSS=y
CONFIG_CEREBRI_ACTUATE_SOUND=n

# can
CONFIG_CEREBRI_SYNAPSE_VESC_CAN=y
CONFIG_CEREBRI_SYNAPSE_VESC_CAN_STATUS=n
CONFIG_CEREBRI_ACTUATE_VESC_CAN=y
CONFIG_CEREBRI_SYNAPSE_VESC_CAN_NUMBER=1
CONFIG_CEREBRI_SYNAPSE_VESC_CAN_BUS_FD_0=y
CONFIG_CEREBRI_SYNAPSE_VESC_CAN_BUS_ALIAS_CAN_N_0=0
CONFIG_CEREBRI_SYNAPSE_VESC_CAN_ID_0=60
CONFIG_CEREBRI_SYNAPSE_VESC_POLE_PAIR_0=7
CONFIG_CEREBRI_SYNAPSE_VESC_CAN_ACTUATOR_VEL_IDX_0=0

CONFIG_PWM=y

CONFIG_CAN=y
CONFIG_CAN_MAX_FILTER=5
CONFIG_CAN_SHELL=y

CONFIG_NET_DRIVERS=y
CONFIG_NET_CANBUS=y

CONFIG_NET_SOCKETS_CAN=y
CONFIG_NET_DEFAULT_IF_CANBUS_RAW=y

CONFIG_CAN_LOG_LEVEL_DBG=n
CONFIG_CAN_FD_MODE=y
CONFIG_SHELL_ARGC_MAX=72
CONFIG_I2C=y
CONFIG_SENSOR=y
CONFIG_HEAP_MEM_POOL_SIZE=16384

# Debugging
CONFIG_DEBUG_THREAD_INFO=y

# Logging
CONFIG_LOG=y
#CONFIG_LOG_MODE_DEFERRED=n
#CONFIG_LOG_BACKEND_NET=n
#CONFIG_LOG_BACKEND_NET_SERVER="192.0.2.2"
```

## app/esc_passthrough/testcase.yaml
```yaml
# SPDX-License-Identifier: Apache-2.0
# Copyright (c) 2025 CogniPilot Foundation
#
# ESC Passthrough USB Protocol Tests
#
# These pytest tests run against the MAIN app (not Ztest), simulating what
# AM32.ca configurator does over USB CDC.
#
# Run with:
#   west twister -T app/esc_passthrough \
#     -p vmu_rt1170/mimxrt1176/cm7 \
#     --device-testing --device-serial /dev/ttyUSB0 \
#     --west-runner jlink
#
# The tests communicate over USB CDC (/dev/ttyACM0) while twister monitors
# the console on /dev/ttyUSB0.

common:
  tags: esc passthrough usb protocol

tests:
  # USB Protocol tests - pytest-based, simulates AM32 configurator
  # Builds the MAIN app and tests MSP + 4-way interface over USB CDC
  esc_passthrough.usb_protocol:
    tags: hardware usb protocol pytest
    platform_allow:
      - vmu_rt1170/mimxrt1176/cm7
    harness: pytest
    harness_config:
      pytest_root:
        - tests/pytest/
      pytest_dut_scope: session
    timeout: 120
```

## app/esc_passthrough/tests/Kconfig
```kconfig
# Copyright (c) 2025 CogniPilot Foundation
# SPDX-License-Identifier: Apache-2.0

config TEST_HARDWARE
	bool "Include hardware tests (requires real ESC)"
	default n
	help
	  Enable hardware tests that require a real ESC connected.
	  These tests will query the ESC bootloader and test read/write.
	  Only enable when running on actual hardware with ESC connected.

source "Kconfig.zephyr"
```

## app/esc_passthrough/tests/testcase.yaml
```yaml
# SPDX-License-Identifier: Apache-2.0
# Copyright (c) 2025 CogniPilot Foundation
#
# ESC Passthrough Tests
#
# Run CI tests (no hardware):
#   west twister -T app/esc_passthrough/tests -p native_sim
#
# Run HW tests (requires ESC connected):
#   west twister -T app/esc_passthrough/tests \
#     -p vmu_rt1170/mimxrt1176/cm7 \
#     --device-testing --device-serial /dev/ttyUSB0 \
#     --west-runner jlink \
#     -s esc_passthrough.hardware
#
# Note: USB protocol tests (pytest) are in app/esc_passthrough/testcase.yaml
#       Run with: west twister -T app/esc_passthrough -p vmu_rt1170/mimxrt1176/cm7 ...
#
# Note: Use /dev/ttyUSB0 (UART console on debug cable) for twister
#
# Or build/flash manually:
#   west build -b vmu_rt1170/mimxrt1176/cm7 app/esc_passthrough/tests \
#     -DCONFIG_TEST_HARDWARE=y -p && west flash -r jlink

common:
  tags: esc passthrough
  min_ram: 32

tests:
  # CI Tests - Protocol verification without hardware
  # These run in cloud CI automatically
  esc_passthrough.protocol.ci:
    tags: ci protocol crc parsing
    platform_allow:
      - native_sim
      - qemu_cortex_m3
    integration_platforms:
      - native_sim
    harness: console
    harness_config:
      type: one_line
      regex:
        - "PROJECT EXECUTION SUCCESSFUL"

  # Hardware tests - require real VMU with ESC connected
  # Excluded from CI, run with --device-testing
  esc_passthrough.hardware:
    tags: hardware
    platform_allow:
      - vmu_rt1170/mimxrt1176/cm7
    extra_configs:
      - CONFIG_TEST_HARDWARE=y
      - CONFIG_GPIO=y
      - CONFIG_LOG=y
    harness: console
    harness_config:
      type: one_line
      regex:
        - "PROJECT EXECUTION SUCCESSFUL"
    timeout: 120
```

## app/icm42688/boards/vmu_rt1170_mimxrt1176_cm7.conf
```kconfig
CONFIG_DEBUG=y
CONFIG_SPI_MCUX_LPSPI_DMA=n
CONFIG_SPI_ASYNC=y
CONFIG_SYS_CLOCK_TICKS_PER_SEC=10000
```

## app/icm42688/dts/bindings/test-icm42688.yaml
```yaml
#
# Copyright (c) 2022 Kumar Gala <galak@kernel.org>
#
# SPDX-License-Identifier: Apache-2.0
#

description: |
    This binding provides resources required to build and run the
    tests icm42688 driver

compatible: "test-icm42688"

include: [spi-device.yaml]
```

## app/rdd2/boards/vmu_rt1170_mimxrt1176_cm7.conf
```kconfig
CONFIG_SPEED_OPTIMIZATIONS=y
CONFIG_SIZE_OPTIMIZATIONS=n

CONFIG_TEST=y
CONFIG_UBSAN=n
CONFIG_ASSERT=y
CONFIG_ASSERT_LEVEL=2
CONFIG_ASSERT_VERBOSE=y

CONFIG_CMSIS_DSP=y
CONFIG_CMSIS_DSP_FILTERING=y


CONFIG_SYSTEM_WORKQUEUE_STACK_SIZE=4096

CONFIG_STACK_CANARIES=y

CONFIG_ISR_STACK_SIZE=8192

CONFIG_LOG_MODE_DEFERRED=y
CONFIG_LOG_MODE_IMMEDIATE=n

CONFIG_FPU=y

# gains
CONFIG_CEREBRI_RDD2_THRUST_TRIM=10976
CONFIG_CEREBRI_RDD2_THRUST_DELTA=10976

CONFIG_CEREBRI_RDD2_ROLL_KP=0
CONFIG_CEREBRI_RDD2_PITCH_KP=0
CONFIG_CEREBRI_RDD2_YAW_KP=0

#CONFIG_CEREBRI_RDD2_ROLLRATE_KP=0
#CONFIG_CEREBRI_RDD2_PITCHRATE_KP=0
#CONFIG_CEREBRI_RDD2_YAWRATE_KP=0

CONFIG_CEREBRI_RDD2_ROLLRATE_KP=300000
CONFIG_CEREBRI_RDD2_PITCHRATE_KP=300000
CONFIG_CEREBRI_RDD2_YAWRATE_KP=50000

CONFIG_CEREBRI_RDD2_ROLLRATE_KI=0
CONFIG_CEREBRI_RDD2_PITCHRATE_KI=0
CONFIG_CEREBRI_RDD2_YAWRATE_KI=0

CONFIG_CEREBRI_RDD2_ROLLRATE_IMAX=0
CONFIG_CEREBRI_RDD2_PITCHRATE_IMAX=0
CONFIG_CEREBRI_RDD2_YAWRATE_IMAX=0

CONFIG_CEREBRI_RDD2_ROLLRATE_KD=10000
CONFIG_CEREBRI_RDD2_PITCHRATE_KD=10000
CONFIG_CEREBRI_RDD2_YAWRATE_KD=0
CONFIG_CEREBRI_RDD2_ATTITUDE_RATE_FCUT=10000

# RDD2 APPS
CONFIG_CEREBRI_RDD2_ALLOCATION=y
CONFIG_CEREBRI_RDD2_ANGULAR_VELOCITY=y
CONFIG_CEREBRI_RDD2_ATTITUDE=y
CONFIG_CEREBRI_RDD2_COMMAND=y
CONFIG_CEREBRI_RDD2_ESTIMATE=y
CONFIG_CEREBRI_RDD2_ESTIMATE_ODOMETRY_ETHERNET=n
CONFIG_CEREBRI_RDD2_FSM=y
CONFIG_CEREBRI_RDD2_LIGHTING=n
CONFIG_CEREBRI_RDD2_POSITION=y

# disabled for first live flight
CONFIG_CEREBRI_ACTUATE_PWM_SHELL=n
CONFIG_CEREBRI_ACTUATE_SOUND=y

# config
CONFIG_INPUT=y
CONFIG_INPUT_SBUS_THREAD_STACK_SIZE=8192
CONFIG_INPUT_EVENT_DUMP=n
CONFIG_INPUT_SHELL=n
CONFIG_INPUT_MODE_SYNCHRONOUS=n
CONFIG_INPUT_SBUS_REPORT_FILTER=0
CONFIG_INPUT_THREAD_STACK_SIZE=2048

CONFIG_CEREBRI_SYNAPSE_LOG_SDCARD=y
CONFIG_CEREBRI_SENSE_IMU=y
CONFIG_CEREBRI_SENSE_ACCEL=n
CONFIG_CEREBRI_SENSE_ICM42688=n

CONFIG_CEREBRI_SENSE_SBUS=y
CONFIG_CEREBRI_SENSE_MAG=y
CONFIG_CEREBRI_SENSE_SAFETY=y
CONFIG_CEREBRI_SENSE_UBX_GNSS=y

CONFIG_CEREBRI_SYNAPSE_ETH_RX=y
CONFIG_CEREBRI_SYNAPSE_ETH_TX=y
CONFIG_CEREBRI_ACTUATE_LED_ARRAY=y
CONFIG_CEREBRI_SENSE_POWER=y

CONFIG_PWM=y

CONFIG_LED_STRIP=y
CONFIG_APA102_STRIP=y
CONFIG_CEREBRI_SENSE_MAG_COUNT=2

CONFIG_CAN=y
CONFIG_CAN_MAX_FILTER=5
CONFIG_CAN_SHELL=y

CONFIG_NET_DRIVERS=y
CONFIG_NET_CANBUS=y

CONFIG_NET_SOCKETS_CAN=y
CONFIG_NET_DEFAULT_IF_CANBUS_RAW=y

CONFIG_CAN_LOG_LEVEL_DBG=n
CONFIG_CAN_FD_MODE=y
CONFIG_SHELL_ARGC_MAX=72
CONFIG_I2C=y
CONFIG_SENSOR=y
CONFIG_SENSOR_SHELL=y
CONFIG_HEAP_MEM_POOL_SIZE=16384

# Debugging
CONFIG_DEBUG_THREAD_INFO=y

# Logging
#CONFIG_LOG_BACKEND_NET=n
#CONFIG_LOG_BACKEND_NET_SERVER="192.0.2.2"
```

## app/rddrone/boards/vmu_rt1170.conf
```kconfig
CONFIG_DREAM_SITL=n
CONFIG_ACTUATE_PWM=y
CONFIG_ACTUATE_PWM_NUMBER=3

CONFIG_PWM=y

CONFIG_CAN=y
CONFIG_CAN_MAX_FILTER=5
CONFIG_CAN_SHELL=y

CONFIG_NET_DRIVERS=y
CONFIG_NET_CANBUS=y

CONFIG_NET_SOCKETS_CAN=y
CONFIG_NET_DEFAULT_IF_CANBUS_RAW=y

CONFIG_CAN_LOG_LEVEL_DBG=n
CONFIG_CAN_FD_MODE=y
CONFIG_SHELL_ARGC_MAX=72
CONFIG_I2C=y
CONFIG_SENSOR=y
CONFIG_SENSE_POWER=y
CONFIG_SENSE_UBX_GNSS=y
CONFIG_HEAP_MEM_POOL_SIZE=16384

# Debugging
CONFIG_DEBUG_THREAD_INFO=y

# Logging
CONFIG_LOG=y
CONFIG_LOG_MODE_DEFERRED=n
CONFIG_LOG_BACKEND_NET=n
CONFIG_LOG_BACKEND_NET_SERVER="192.0.2.2"
```

## app/rddrone/sample.yaml
```yaml
sample:
  description: RDDRONE
  name: RDDRONE
common:
  build_only: true
  integration_platforms:
    - native_posix
    - vmu_rt1170
tests:
  rddrone.default: {}
```

## apps/rover/Kconfig
```kconfig
# Copyright (c) 2023 CogniPilot Foundation
# SPDX-License-Identifier: Apache-2.0
#
# This file is the application Kconfig entry point. All application Kconfig
# options can be defined here or included via other application Kconfig files.
# You can browse these options using the west targets menuconfig (terminal) or
# guiconfig (GUI).

menu "Zephyr"
source "Kconfig.zephyr"
endmenu

module = ROVER
module-str = ROVER
source "subsys/logging/Kconfig.template.log_config"
```

## build-native_sim/Kconfig/Kconfig.modules
```kconfig
menu "cmsis_6 (/home/jgoppert/cognipilot/ws/modules/hal/cmsis_6)"
osource "$(ZEPHYR_CMSIS_6_KCONFIG)"
config ZEPHYR_CMSIS_6_MODULE
	bool
	default y
endmenu
menu "hal_nxp (/home/jgoppert/cognipilot/ws/modules/hal/nxp)"
osource "$(ZEPHYR_HAL_NXP_KCONFIG)"
config ZEPHYR_HAL_NXP_MODULE
	bool
	default y

config ZEPHYR_HAL_NXP_MODULE_BLOBS
	bool
endmenu
config ZEPHYR_ZEPHYR_BOARDS_MODULE
	bool
	default y
```

## build-native_sim/Kconfig/Kconfig.shield.defconfig
```kconfig
osource "/home/jgoppert/cognipilot/ws/modules/lib/zephyr_boards/boards/shields/*/Kconfig.defconfig"
```

## build-native_sim/Kconfig/Kconfig.sysbuild.modules
```kconfig
config ZEPHYR_CMSIS_6_MODULE
   bool
   default y
config ZEPHYR_HAL_NXP_MODULE
   bool
   default y
config ZEPHYR_ZEPHYR_BOARDS_MODULE
   bool
   default y
```

## build-native_sim/Kconfig/arch/Kconfig
```kconfig
# Load Zephyr Arch Kconfig descriptions.
osource "/home/jgoppert/cognipilot/ws/zephyr/arch/rx/Kconfig"
osource "/home/jgoppert/cognipilot/ws/zephyr/arch/x86/Kconfig"
osource "/home/jgoppert/cognipilot/ws/zephyr/arch/xtensa/Kconfig"
osource "/home/jgoppert/cognipilot/ws/zephyr/arch/sparc/Kconfig"
osource "/home/jgoppert/cognipilot/ws/zephyr/arch/riscv/Kconfig"
osource "/home/jgoppert/cognipilot/ws/zephyr/arch/posix/Kconfig"
osource "/home/jgoppert/cognipilot/ws/zephyr/arch/mips/Kconfig"
osource "/home/jgoppert/cognipilot/ws/zephyr/arch/arm64/Kconfig"
osource "/home/jgoppert/cognipilot/ws/zephyr/arch/arm/Kconfig"
osource "/home/jgoppert/cognipilot/ws/zephyr/arch/arc/Kconfig"
```

## build-native_sim/Kconfig/boards/Kconfig.defconfig
```kconfig
# Load Zephyr board defconfig descriptions.
osource "/home/jgoppert/cognipilot/ws/zephyr/boards/native/native_sim/Kconfig.defconfig"
```

## build-native_sim/Kconfig/boards/Kconfig.native_sim
```kconfig
# Load board Kconfig descriptions.
osource "/home/jgoppert/cognipilot/ws/zephyr/boards/native/native_sim/Kconfig.native_sim"
```
