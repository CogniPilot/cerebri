/* SPDX-License-Identifier: Apache-2.0 */
/* Copyright 2023 CogniPilot Foundation */

&lpspi1 {
	/delete-node/ icm42688p0@0;
	/delete-property/ dmas;
	/delete-property/ dma-names;
};

&lpspi2 {
	/delete-node/ icm42688p1@0;
	status = "okay";
	cs-gpios =<&gpio3 24 GPIO_ACTIVE_LOW>;

	slow: slow@0 {
		compatible = "test-icm42688";
		reg = <0>;
		spi-max-frequency = <500000>;
	};
};
