## CMakeLists.txt
```
#-------------------------------------------------------------------------------
# Zephyr Cerebri Application
#
# Copyright (c) 2023 CogniPilot Foundation
# SPDX-License-Identifier: Apache-2.0

cmake_minimum_required(VERSION 3.13.1)

if (NOT DEFINED BOARD)
  set(BOARD "native_posix_64")
endif()

find_package(Zephyr REQUIRED HINTS $ENV{ZEPHYR_BASE})

project(app LANGUAGES C VERSION 0.0.1)

target_compile_options(app PRIVATE -Wall -Wextra -Werror)

configure_file(app_version.h.in ${CMAKE_BINARY_DIR}/app/include/app_version.h)
target_include_directories(app PRIVATE ${CMAKE_BINARY_DIR}/app/include src)

set(SOURCE_FILES
  src/main.c
  )

target_sources(app PRIVATE ${SOURCE_FILES})
```

## Kconfig
```
# Copyright (c) 2021 Nordic Semiconductor ASA
# SPDX-License-Identifier: Apache-2.0
#
# This file is the application Kconfig entry point. All application Kconfig
# options can be defined here or included via other application Kconfig files.
# You can browse these options using the west targets menuconfig (terminal) or
# guiconfig (GUI).

menu "Cerebri"
source "Kconfig.zephyr"
endmenu

module = APP
module-str = APP
source "subsys/logging/Kconfig.template.log_config"
```

## prj.conf
```kconfig
CONFIG_SHELL=y
CONFIG_SERIAL=y
CONFIG_CONSOLE=y
CONFIG_NANOPB=y
CONFIG_LOG=y
CONFIG_LOG_MODE_MINIMAL=y
CONFIG_BOOT_BANNER=n
CONFIG_MAIN_THREAD_PRIORITY=5

#CONFIG_HEAP_MEM_POOL_SIZE=102400

CONFIG_ZBUS=y
CONFIG_ZBUS_LOG_LEVEL_INF=y
CONFIG_ZBUS_CHANNEL_NAME=y
CONFIG_ZBUS_OBSERVER_NAME=y

CONFIG_SYNAPSE_ZBUS=y
CONFIG_SYNAPSE_ZBUS_UART=y
CONFIG_SYNAPSE_ZBUS_ETHERNET=y
CONFIG_SYNAPSE_TINYFRAME=y
CONFIG_SYNAPSE_PROTOBUF=y
CONFIG_CONTROL_ROVER=y
CONFIG_CONTROL_ROVER_STEERING_DIFFERENTIAL=y

# General config
#CONFIG_NEWLIB_LIBC=y
#CONFIG_MAIN_STACK_SIZE=102400

CONFIG_NET_SHELL=y

# Networking config
CONFIG_NETWORKING=y
CONFIG_NET_IPV4=y
CONFIG_NET_IPV6=n
CONFIG_NET_TCP=y
CONFIG_NET_SOCKETS=y

# Network address config
CONFIG_NET_CONFIG_SETTINGS=y
CONFIG_NET_CONFIG_NEED_IPV4=y
CONFIG_NET_CONFIG_MY_IPV4_ADDR="192.0.2.1"
CONFIG_NET_CONFIG_PEER_IPV4_ADDR="192.0.2.2"
```

## boards/native_posix_64.conf
```kconfig
CONFIG_ETH_NATIVE_POSIX=y
CONFIG_TEST_RANDOM_GENERATOR=y
CONFIG_SYS_CLOCK_TICKS_PER_SEC=1000
CONFIG_NATIVE_POSIX_SLOWDOWN_TO_REAL_TIME=n

CONFIG_UART_NATIVE_POSIX_PORT_1_ENABLE=n

CONFIG_CEREBRI_SIM=y
CONFIG_SYNAPSE_ZBUS_ETHERNET=n
CONFIG_SYNAPSE_ZBUS_UART=n
```

## src/main.c
```c
/*
 * Copyright (c) 2023 CogniPilot Foundation
 * SPDX-License-Identifier: Apache-2.0
 */

#if defined(CONFIG_ARCH_POSIX)
#include <signal.h>
#endif

#include <stdio.h>
#include <stdlib.h>
#include <zephyr/drivers/sensor.h>
#include <zephyr/kernel.h>

#include "app_version.h"

#include <zephyr/logging/log.h>
LOG_MODULE_REGISTER(main, CONFIG_APP_LOG_LEVEL);

static volatile int keepRunning = 1;

#if defined(CONFIG_ARCH_POSIX)
void intHandler(int dummy)
{
    (void)dummy;
    keepRunning = 0;
    printf("sigint caught\n");
    exit(0);
}
#endif

void main(void)
{
    printk("Cerebri %s\n", APP_VERSION_STR);
#if defined(CONFIG_ARCH_POSIX)
    signal(SIGINT, intHandler);
#endif
    while (keepRunning) {
        k_msleep(10000);
        //int64_t uptime = k_uptime_get() / 1e3;
#if defined(CONFIG_ARCH_POSIX)
        //printf("\nuptime: %ld sec\n", uptime);
#else
        //printf("\nuptime: %lld sec\n", uptime);
#endif
    }
}

// vi: ts=4 sw=4 et
```
