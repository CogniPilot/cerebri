## CMakeLists.txt
```
cmake_minimum_required(VERSION 3.20.0)

enable_language(CXX)

set(BOARD native_posix_64)

find_package(Zephyr REQUIRED HINTS $ENV{ZEPHYR_BASE})

project(cerebri)

target_sources(app PRIVATE
    src/main.c
    src/estimator.c
    src/controller.c
)
```

## prj.conf
```kconfig
CONFIG_NETWORKING=y
CONFIG_NET_UDP=y
CONFIG_NET_TCP=y
CONFIG_NET_IPV6=y
CONFIG_NET_IPV4=y
CONFIG_ETH_NATIVE_POSIX_STARTUP_AUTOMATIC=n
CONFIG_NET_SOCKETS=y
#CONFIG_NET_DHCPV4=y
CONFIG_NET_SOCKETS_POSIX_NAMES=y
CONFIG_NET_MGMT=y

CONFIG_ENTROPY_GENERATOR=y
CONFIG_TEST_RANDOM_GENERATOR=y
CONFIG_INIT_STACKS=y

CONFIG_NET_LOG=y
CONFIG_LOG=y

CONFIG_NET_STATISTICS=y

CONFIG_NET_PKT_RX_COUNT=32
CONFIG_NET_PKT_TX_COUNT=32
CONFIG_NET_BUF_RX_COUNT=32
CONFIG_NET_BUF_TX_COUNT=32

CONFIG_NET_IF_UNICAST_IPV6_ADDR_COUNT=3
CONFIG_NET_IF_MCAST_IPV6_ADDR_COUNT=4
CONFIG_NET_MAX_CONTEXTS=10

##CONFIG_NET_SHELL=y

CONFIG_NET_CONFIG_SETTINGS=y
CONFIG_NET_CONFIG_NEED_IPV6=y
CONFIG_NET_CONFIG_NEED_IPV4=y
CONFIG_NET_CONFIG_MY_IPV6_ADDR="2001:db8::1"
CONFIG_NET_CONFIG_PEER_IPV6_ADDR="2001:db8::2"
CONFIG_NET_CONFIG_MY_IPV4_ADDR="192.0.2.1"
CONFIG_NET_CONFIG_PEER_IPV4_ADDR="192.0.2.2"

CONFIG_NET_L2_ETHERNET=y

CONFIG_ETH_NATIVE_POSIX=y
CONFIG_ETH_NATIVE_POSIX_RANDOM_MAC=y
#CONFIG_ETH_NATIVE_POSIX_MAC_ADDR="00:00:5e:00:53:2a"
CONFIG_NO_OPTIMIZATIONS=y

CONFIG_SYS_CLOCK_TICKS_PER_SEC=1000
CONFIG_NATIVE_POSIX_SLOWDOWN_TO_REAL_TIME=n

CONFIG_SHELL=y
CONFIG_CPLUSPLUS=y
CONFIG_LIB_CPLUSPLUS=y
CONFIG_CPP_MAIN=y
#CONFIG_MINIMAL_LIBC_MALLOC_ARENA_SIZE=128
CONFIG_STD_CPP17=y
CONFIG_EXCEPTIONS=y

CONFIG_ASAN=y
CONFIG_NO_OPTIMIZATIONS=y

CONFIG_ZBUS=y
CONFIG_ZBUS_LOG_LEVEL_INF=y
CONFIG_ZBUS_CHANNEL_NAME=y
CONFIG_ZBUS_OBSERVER_NAME=y

#CONFIG_CEREBRI_DRIVER_SIM_CORE=y
#CONFIG_CEREBRI_DRIVER_SIM_GZ=y
```

## src/controller.c
```c
#include <zephyr/kernel.h>
#include <math.h>

#include "channels.h"
#include <stdio.h>

float gx = 0;
float gy = 0;
float gz = 0;void listener_controller_callback(const struct zbus_channel *chan) {
    
    
    if (chan == &chan_rc_input) {
        const struct msg_rc_input_t *msg_rc_input = (const struct msg_rc_input_t *)zbus_chan_const_msg(chan);
        struct msg_actuators_t actuators_msg;
        double vt = msg_rc_input->thrust;

        double vy = msg_rc_input->yaw;
  
        bool armed = msg_rc_input->armed;

        double mix_thrust = armed ? vt : 0;
        double mix_yaw = armed ? vy : 0;
    
        double scale0 = (0.3 - -0.3) / 2.0;
        double actuator0 = 0*mix_thrust*scale0 + 1*mix_yaw*scale0;
        if(actuator0 > 0.3) {
            actuator0 = 0.3;
        } else if (actuator0 < -0.3) {
            actuator0 = -0.3;
        }
        actuators_msg.actuator0_value = actuator0;
    
        double scale1 = (50 - -50) / 2.0;
        double actuator1 =  1*mix_thrust*scale1 +  0*mix_yaw*scale1;
        if(actuator1 > 50) {
            actuator1 = 50;
        } else if (actuator1 < -50) {
            actuator1 = -50;
        }
        actuators_msg.actuator1_value = actuator1;
    

        zbus_chan_pub(&chan_actuators, &actuators_msg, K_NO_WAIT);

    } else if (chan == &chan_gyroscope) {
        const struct msg_gyroscope_t * msg_gyroscope = (const struct msg_gyroscope_t *)zbus_chan_const_msg(chan);
        gx = msg_gyroscope->x;
        gy = msg_gyroscope->y;
        gz = msg_gyroscope->z;
    }
}
ZBUS_LISTENER_DEFINE(listener_controller, listener_controller_callback);
```

## src/estimator.c
```c
#include <zephyr/kernel.h>
#include <math.h>
#include <stdio.h>

#include "channels.h"

void listener_estimator_callback(const struct zbus_channel *chan) {
    if (chan == &chan_accelerometer) {
        //const struct msg_accelerometer_t *msg = (const struct msg_accelerometer_t *)zbus_chan_const_msg(chan);
    } else if (chan == &chan_gyroscope) {
        //const struct msg_gyroscope_t *msg = (const struct msg_gyroscope_t *)zbus_chan_const_msg(chan);
    } else if (chan == &chan_magnetometer) {
        //const struct msg_magnetometer_t *msg = (const struct msg_magnetometer_t *)zbus_chan_const_msg(chan);
    } else if (chan == &chan_altimeter) {
        //const struct msg_altimeter_t *msg = (const struct msg_altimeter_t *)zbus_chan_const_msg(chan);
    } else if (chan == &chan_navsat) {
        //const struct msg_navsat_t *msg = (const struct msg_navsat_t *)zbus_chan_const_msg(chan);
    }
}
ZBUS_LISTENER_DEFINE(listener_estimator, listener_estimator_callback);
```
