## drivers/actuate/dshot/Kconfig
```kconfig
# Copyright (c) 2024, CogniPilot Foundation
# SPDX-License-Identifier: Apache-2.0

menuconfig CEREBRI_ACTUATE_DSHOT
  bool "DShot"
  depends on ZROS
  default y if DT_HAS_CEREBRI_DSHOT_ACTUATORS_ENABLED
  help
    This option enables dshot actuators

if CEREBRI_ACTUATE_DSHOT

config CEREBRI_ACTUATE_DSHOT_SHELL
  bool "Enable shell"
  help
    Enable shell

module = CEREBRI_ACTUATE_DSHOT
module-str = actuate_dshot
source "subsys/logging/Kconfig.template.log_config"

endif #CEREBRI_ACTUATE_DSHOT
```

## drivers/actuate/led_array/Kconfig
```kconfig
# Copyright (c) 2023, CogniPilot Foundation
# SPDX-License-Identifier: Apache-2.0

menuconfig CEREBRI_ACTUATE_LED_ARRAY
  bool "LED ARRAY"
  help
    This option enables the LED ARRAY

if CEREBRI_ACTUATE_LED_ARRAY

config CEREBRI_ACTUATE_LED_ARRAY_COUNT
  int "Number of LEDs in array"
  default 12
  range 1 255
  help
    Defines number of LEDS in array



module = CEREBRI_ACTUATE_LED_ARRAY
module-str = actuate_led_array
source "subsys/logging/Kconfig.template.log_config"

endif #CEREBRI_ACTUATE_LED_ARRAY
```

## drivers/actuate/vesc_can/Kconfig
```kconfig
# Copyright (c) 2023, CogniPilot Foundation
# SPDX-License-Identifier: Apache-2.0

menuconfig CEREBRI_ACTUATE_VESC_CAN
  bool "VESC_CAN"
  depends on CAN
  depends on ZROS
  default y if DT_HAS_CEREBRI_VESC_CAN_ACTUATORS_ENABLED
  help
    This option enables vesc_can actuators

if CEREBRI_ACTUATE_VESC_CAN

config CEREBRI_ACTUATE_VESC_CAN_SHELL
  bool "Enable shell"
  help
    Enable shell

module = CEREBRI_ACTUATE_VESC_CAN
module-str = actuate_vesc_can
source "subsys/logging/Kconfig.template.log_config"

endif #CEREBRI_ACTUATE_VESC_CAN
```

## drivers/dream/Kconfig
```kconfig
# Copyright (c) 2023 CogniPilot Foundation
# SPDX-License-Identifier: Apache-2.0

menu "Dream"

rsource "sil/Kconfig"
rsource "hil/Kconfig"

endmenu
```

## drivers/dream/hil/Kconfig
```kconfig
# Copyright (c) 2023, CogniPilot Foundation
# SPDX-License-Identifier: Apache-2.0

menuconfig CEREBRI_DREAM_HIL
  bool "HIL"
  help
    This option enables the cerebri hil sim

if CEREBRI_DREAM_HIL

module = CEREBRI_DREAM_HIL
module-str = dream_hil
source "subsys/logging/Kconfig.template.log_config"

endif  # CEREBRI_DREAM_HIL
```

## drivers/dream/sil/Kconfig
```kconfig
# Copyright (c) 2023, CogniPilot Foundation
# SPDX-License-Identifier: Apache-2.0

menuconfig CEREBRI_DREAM_SIL
  bool "SIL"
  depends on ZROS
  help
    This option enables the cerebri sil sim

if CEREBRI_DREAM_SIL

module = CEREBRI_DREAM_SIL
module-str = dream_sil
source "subsys/logging/Kconfig.template.log_config"

endif  # CEREBRI_DREAM_SIL
```

## drivers/dream/sitl/Kconfig
```kconfig
# Copyright (c) 2023, CogniPilot Foundation
# SPDX-License-Identifier: Apache-2.0

config DREAM_SITL
  bool "enable sitl simulation"
  help
    This option enables the cerebri sitl sim

if DREAM_SITL

endif  # DREAM_SITL

module = DREAM_SITL
module-str = dream_sitl
source "subsys/logging/Kconfig.template.log_config"
```

## drivers/input/Kconfig
```kconfig
# Copyright (c) 2023 CogniPilot Foundation
# SPDX-License-Identifier: Apache-2.0

if INPUT

menu "Input drivers"

rsource "mcux_gpt_ppm/Kconfig"

endmenu # Input Drivers

endif # INPUT
```

## drivers/nxp_flexio_dshot/Kconfig
```kconfig
config CEREBRI_DSHOT
	bool "Enable cerebri FlexIO DSHOT support"
	depends on DT_HAS_NXP_FLEXIO_ENABLED
	default y
	select MCUX_FLEXIO
	help
	  Select the Zephyr FlexIO support required by the local cerebri
	  DSHOT driver.
```

## drivers/sense/Kconfig
```kconfig
# Copyright (c) 2023 CogniPilot Foundation
# SPDX-License-Identifier: Apache-2.0

menu "Sense"

rsource "accel/Kconfig"
rsource "icm42688/Kconfig"
rsource "power/Kconfig"
rsource "safety/Kconfig"
rsource "sbus/Kconfig"
rsource "vesc_can_status/Kconfig"
rsource "wheel_odometry/Kconfig"

endmenu
```

## drivers/sense/accel/Kconfig
```kconfig
# Copyright (c) 2023, CogniPilot Foundation
# SPDX-License-Identifier: Apache-2.0
menuconfig CEREBRI_SENSE_ACCEL
  bool "ACCEL"
  depends on CEREBRI_CORE_COMMON
  depends on ZROS
  help
    This option enables the ACCEL driver interface

if CEREBRI_SENSE_ACCEL

config CEREBRI_SENSE_ACCEL_COUNT
  int "Number of accelerometers"
  default 1
  range 1 4
  help
    Defines number of accelerometers 1-4

module = CEREBRI_SENSE_ACCEL
module-str = sense_accel
source "subsys/logging/Kconfig.template.log_config"

endif # CEREBRI_SENSE_ACCEL
```

## drivers/sense/imu/Kconfig
```kconfig
# Copyright (c) 2023, CogniPilot Foundation
# SPDX-License-Identifier: Apache-2.0
config SENSE_IMU
  bool "Use IMU driver interface"
  default n
  help
    This option enables the IMU driver interface


module = SENSE_IMU
module-str = sense_imu
source "subsys/logging/Kconfig.template.log_config"
```

## drivers/sense/ina226/Kconfig
```kconfig
# Copyright (c) 2023, CogniPilot Foundation
# SPDX-License-Identifier: Apache-2.0

config SENSE_INA226
  bool "Use sensor INA226"
  default n  
  help
    This option enables INA226 battery sensor.
```

## drivers/sense/mag/Kconfig
```kconfig
# Copyright (c) 2023, CogniPilot Foundation
# SPDX-License-Identifier: Apache-2.0
config SENSE_MAG
  bool "Use MAG"
  default n
  help
    This option enables the MAG driver interface


module = SENSE_MAG
module-str = sense_mag
source "subsys/logging/Kconfig.template.log_config"
```

## drivers/sense/power/Kconfig
```kconfig
# Copyright (c) 2023, CogniPilot Foundation
# SPDX-License-Identifier: Apache-2.0

config SENSE_POWER
  bool "Use power sensor"
  default n  
  help
    This option enables power sensor.

module = SENSE_POWER
module-str = sense_power
source "subsys/logging/Kconfig.template.log_config"
```

## drivers/sense/rc/Kconfig
```kconfig
# Copyright (c) 2025, CogniPilot Foundation
# SPDX-License-Identifier: Apache-2.0
menuconfig CEREBRI_SENSE_RC
  bool "RC Input"
  default y
  depends on ZROS
  depends on CEREBRI_CORE_WORKQUEUES
  depends on INPUT_MODE_SYNCHRONOUS
  help
    This option enables the RC Input zros publisher

if CEREBRI_SENSE_RC

module = CEREBRI_SENSE_RC
module-str = sense_rc
source "subsys/logging/Kconfig.template.log_config"

endif # CEREBRI_SENSE_RC
```

## drivers/sense/ubx_gnss/Kconfig
```kconfig
config SENSE_UBX_GNSS
  bool "Use U-blox GNSS"
  default n
  select UBXLIB
  help
    This option enables U-blox GNSS driver.


module = UBX_GNSS
module-str = ubx_gnss
source "subsys/logging/Kconfig.template.log_config"
```

## drivers/sense/vesc_can_status/Kconfig
```kconfig
# Copyright (c) 2023, CogniPilot Foundation
# SPDX-License-Identifier: Apache-2.0

menuconfig CEREBRI_SENSE_VESC_CAN_STATUS
  bool "Sense VESC CAN STATUS"
  help
    This option enables vesc can status

if CEREBRI_SENSE_VESC_CAN_STATUS

module = CEREBRI_SENSE_VESC_CAN_STATUS
module-str = sense_vesc_can_status
source "subsys/logging/Kconfig.template.log_config"

endif # CEREBRI_SENSE_VESC_CAN_STATUS
```

## drivers/sense/wheel_odometry/Kconfig
```kconfig
# Copyright (c) 2023, CogniPilot Foundation
# SPDX-License-Identifier: Apache-2.0
menuconfig CEREBRI_SENSE_WHEEL_ODOMETRY
  bool "Wheel Odometry"
  depends on ZROS
  depends on CEREBRI_CORE_COMMON
  depends on SYNAPSE_PB
  help
    This option enables the wheel odometry driver interface

if CEREBRI_SENSE_WHEEL_ODOMETRY

module = CEREBRI_SENSE_WHEEL_ODOMETRY
module-str = sense_wheel_odometry
source "subsys/logging/Kconfig.template.log_config"

endif # CEREBRI_SENSE_WHEEL_ODOMETRY
```

## drivers/sim_core/Kconfig
```kconfig
menuconfig CEREBRI_SIM_CORE
	bool "Cerebri Simulation Core"
	help
		This option enables cerebri simulation core.
```

## drivers/sim_gz/Kconfig
```kconfig
menuconfig CEREBRI_SIM_GZ_DRIVER
	bool "Gazebo Simulation"
	help
		This option enables the gazebo simulation driver.
```

## drivers/synapse/Kconfig
```kconfig
# Copyright (c) 2023 CogniPilot Foundation
# SPDX-License-Identifier: Apache-2.0

menu "Synapse"

rsource "eth_tx/Kconfig"
rsource "eth_rx/Kconfig"
rsource "topic/Kconfig"
rsource "vesc_can/Kconfig"
rsource "log_sdcard/Kconfig"

endmenu
```

## drivers/synapse/eth_rx/Kconfig
```kconfig
# Copyright (c) 2024, CogniPilot Foundation
# SPDX-License-Identifier: Apache-2.0

config CEREBRI_SYNAPSE_ETH_RX
  bool "ethernet rx"	
  default y
  depends on ZROS
  help
    This option enables the synapse udp interface

if CEREBRI_SYNAPSE_ETH_RX

module = CEREBRI_SYNAPSE_ETH_RX
module-str = cerebri_synapse_eth_rx
source "subsys/logging/Kconfig.template.log_config"

endif # CEREBRI_SYNAPSE_ETH_RX
```

## drivers/synapse/eth_tx/Kconfig
```kconfig
# Copyright (c) 2024, CogniPilot Foundation
# SPDX-License-Identifier: Apache-2.0

config CEREBRI_SYNAPSE_ETH_TX
  bool "ethernet tx"	
  default y
  depends on ZROS
  help
    This option enables the synapse udp interface

if CEREBRI_SYNAPSE_ETH_TX

module = CEREBRI_SYNAPSE_ETH_TX
module-str = synapse_eth_tx
source "subsys/logging/Kconfig.template.log_config"

endif # CEREBRI_SYNAPSE_ETH_TX
```

## drivers/synapse/ethernet/Kconfig
```kconfig
# Copyright (c) 2023, CogniPilot Foundation
# SPDX-License-Identifier: Apache-2.0

config SYNAPSE_ETHERNET
  bool "synapse ethernet interface"
  help
    This option enables the synapse ethernet interface

module = SYNAPSE_ETHERNET
module-str = synapse_ethernet
source "subsys/logging/Kconfig.template.log_config"
```
