## drivers/synapse/log_sdcard/Kconfig
```kconfig
# Copyright (c) 2024, CogniPilot Foundation
# SPDX-License-Identifier: Apache-2.0

config CEREBRI_SYNAPSE_LOG_SDCARD
  bool "log sdcard"
  default y
  select RING_BUFFER_LARGE
  depends on ZROS
  help
    This option enables the sdcard logger

if CEREBRI_SYNAPSE_LOG_SDCARD

module = CEREBRI_SYNAPSE_LOG_SDCARD
module-str = synapse_log_sdcard
source "subsys/logging/Kconfig.template.log_config"

endif # CEREBRI_SYNAPSE_LOG_SDCARD
```

## drivers/synapse/rpmsg/Kconfig
```kconfig
config CEREBRI_SYNAPSE_RPMSG
  bool "Enable synapse rpmsg"
  default n
  depends on OPENAMP
  help
    This option enables rpmsg for synapse
```

## drivers/synapse/uart/Kconfig
```kconfig
# Copyright (c) 2023, CogniPilot Foundation
# SPDX-License-Identifier: Apache-2.0

config SYNAPSE_UART
  bool "synapse uart interface"
  help
    This option enables the synapse uart interface

if SYNAPSE_UART

endif  # SYNAPSE_UART

module = SYNAPSE_UART
module-str = synapse_uart
source "subsys/logging/Kconfig.template.log_config"
```

## drivers/synapse/usb_msc/Kconfig
```kconfig
# Copyright (c) 2024, CogniPilot Foundation
# SPDX-License-Identifier: Apache-2.0

config CEREBRI_SYNAPSE_USB_MSC
	bool "USB Mass Storage for SD card access"
	default n
	depends on USB_DEVICE_STACK_NEXT
	depends on USBD_MSC_CLASS
	depends on DISK_DRIVER_SDMMC
	help
	  This option enables USB Mass Storage mode for downloading
	  log files from the SD card. When enabled, shell commands
	  allow switching between logging mode and USB MSC mode.

if CEREBRI_SYNAPSE_USB_MSC

module = CEREBRI_SYNAPSE_USB_MSC
module-str = synapse_usb_msc
source "subsys/logging/Kconfig.template.log_config"

endif # CEREBRI_SYNAPSE_USB_MSC
```

## drivers/synapse/zbus/Kconfig
```kconfig
# Copyright (c) 2023, CogniPilot Foundation
# SPDX-License-Identifier: Apache-2.0

config SYNAPSE_ZBUS
  bool "synapse zbus interface"
  help
    This option enables the synapse zbus interface

if SYNAPSE_ZBUS

endif  # SYNAPSE_ZBUS
```

## drivers/zephyr/Kconfig
```kconfig
# Copyright (c) 2023 CogniPilot Foundation
# SPDX-License-Identifier: Apache-2.0

menu "Out-of-tree Zephyr drivers"

rsource "*/Kconfig"

endmenu
```

## drivers/zephyr/misc/Kconfig
```kconfig
# Copyright (c) 2025 CogniPilot Foundation
# SPDX-License-Identifier: Apache-2.0

rsource "*/Kconfig"
```

## drivers/zephyr/misc/nxp_flexio_dshot/Kconfig
```kconfig
# Copyright 2023 NXP
# SPDX-License-Identifier: Apache-2.0

config NXP_FLEXIO_DSHOT
	bool "NXP FlexIO DShot protocol"
	depends on DT_HAS_NXP_FLEXIO_ENABLED
	depends on CLOCK_CONTROL
	depends on DT_HAS_NXP_FLEXIO_DSHOT_ENABLED
	select MCUX_FLEXIO
	help
	  Enable drivers for DShot using NXP FlexIO

if NXP_FLEXIO_DSHOT

module = NXP_FLEXIO_DSHOT
module-str = NXP FlexIO DShot
source "subsys/logging/Kconfig.template.log_config"

config NXP_FLEXIO_DSHOT_INIT_PRIORITY
	int "NXP FlexIO DShot priority"
	default KERNEL_INIT_PRIORITY_DEVICE
	help
	  System initialization priority for NXP FlexIO DShot driver.

endif
```

## drivers/zephyr/misc/nxp_flexio_uart/Kconfig
```kconfig
# Copyright 2025 CogniPilot Foundation
# SPDX-License-Identifier: Apache-2.0

config NXP_FLEXIO_UART
	bool "NXP FlexIO UART driver"
	default y
	depends on DT_HAS_NXP_FLEXIO_UART_ENABLED
	select MCUX_FLEXIO
	help
	  Enable support for NXP FlexIO-based UART.
	  This driver implements a software UART using the FlexIO peripheral,
	  which can use almost any GPIO pin. Supports half-duplex single-wire
	  mode for protocols like AM32 ESC bootloader communication.

if NXP_FLEXIO_UART

config NXP_FLEXIO_UART_INIT_PRIORITY
	int "FlexIO UART init priority"
	default 80
	help
	  FlexIO UART device driver initialization priority.
	  Must be initialized after FlexIO parent device.

config NXP_FLEXIO_UART_LOG_LEVEL
	int "FlexIO UART log level"
	default 3
	range 0 4
	help
	  Log level for FlexIO UART driver.
	  0 = Off, 1 = Error, 2 = Warning, 3 = Info, 4 = Debug

endif # NXP_FLEXIO_UART
```

## dts/bindings/cognipilot,sitl-udp.yaml
```yaml
# SPDX-License-Identifier: Apache-2.0

description: Cerebri2 native_sim UDP coordinator

compatible: "cognipilot,sitl-udp"

include: base.yaml
```

## dts/bindings/nxp,flexio-dshot.yaml
```yaml
# Copyright 2024 NXP
# SPDX-License-Identifier: Apache-2.0

description: NXP Flexio DSHOT controller.
  Each flexio timer can be used for generating one dshot pulse.
  The two DSHOT modes supported by flexio are chosen based on the selected polarity -
  Dual 8-bit counters DSHOT mode and Dual 8-bit counters DSHOT Low mode.

compatible: "nxp,flexio-dshot"

include: [pinctrl-device.yaml, base.yaml]

properties:
  pinctrl-0:
    required: true

  pinctrl-names:
    required: true

  speed:
    type: int
    default: 600
    description: |
      bitrate of the dshot signal in kbit/s

child-binding:
  description: |
    Flexio DSHOT channel configuration.

  properties:
    pin-id:
      type: int
      required: true
      description: |
        pin-id should be populated with number 'n' specified in the
        FXIO_D<n> data pin of your board's schematic.
    bidirectional-dshot:
      type: boolean
      description: | 
        Enables inverted dshot, where signal level is inverted
        When inverted an DSHOT esc will send back telemetry over 
        the same single wire
```

## dts/bindings/nxp,flexio-uart.yaml
```yaml
# Copyright 2025 CogniPilot Foundation
# SPDX-License-Identifier: Apache-2.0

description: |
  NXP FlexIO UART controller.

  Implements a software UART using the FlexIO peripheral, which can use
  almost any GPIO pin. Supports half-duplex single-wire mode for protocols
  like AM32 ESC bootloader communication.

  Each FlexIO timer/shifter pair provides one UART channel.

compatible: "nxp,flexio-uart"

include: [pinctrl-device.yaml, base.yaml]

properties:
  pinctrl-0:
    required: true

  pinctrl-names:
    required: true

  current-speed:
    type: int
    default: 19200
    description: |
      Baud rate in bits per second. Default is 19200 for AM32 ESC
      bootloader compatibility.

child-binding:
  description: |
    FlexIO UART channel configuration.

  properties:
    pin-id:
      type: int
      required: true
      description: |
        FlexIO data pin number. Should be populated with number 'n'
        specified in the FXIO_D<n> data pin of your board's schematic.
```

## lib/Kconfig
```kconfig
# Copyright (c) 2023 CogniPilot Foundation
# SPDX-License-Identifier: Apache-2.0

menu "Libraries"

rsource "synapse/Kconfig"

rsource "actuate/Kconfig"
rsource "control/Kconfig"
rsource "core/Kconfig"
rsource "dream/Kconfig"
rsource "estimate/Kconfig"
rsource "sense/Kconfig"

endmenu
```

## lib/actuate/led_array/Kconfig
```kconfig
# Copyright (c) 2023, CogniPilot Foundation
# SPDX-License-Identifier: Apache-2.0

menuconfig CEREBRI_ACTUATE_LED_ARRAY
  bool "LED ARRAY"
  help
    This option enables the LED ARRAY

if CEREBRI_ACTUATE_LED_ARRAY

module = CEREBRI_ACTUATE_LED_ARRAY
module-str = actuate_led_array
source "subsys/logging/Kconfig.template.log_config"

endif #CEREBRI_ACTUATE_LED_ARRAY
```

## lib/actuate/pwm/Kconfig
```kconfig
# Copyright (c) 2023, CogniPilot Foundation
# SPDX-License-Identifier: Apache-2.0

menuconfig CEREBRI_ACTUATE_PWM
  bool "PWM"
  depends on PWM
  depends on ZROS
  help
    This option enables pwm actuators

if CEREBRI_ACTUATE_PWM

config CEREBRI_ACTUATE_PWM_SHELL
  bool "Enable shell"
  help
    Enable shell

module = CEREBRI_ACTUATE_PWM
module-str = actuate_pwm
source "subsys/logging/Kconfig.template.log_config"

endif #CEREBRI_ACTUATE_PWM
```

## lib/actuate/sound/Kconfig
```kconfig
# Copyright (c) 2023, CogniPilot Foundation
# SPDX-License-Identifier: Apache-2.0

menuconfig CEREBRI_ACTUATE_SOUND
  bool "SOUND"
  depends on PWM
  help
    This option enables sound tones

if CEREBRI_ACTUATE_SOUND

module = CEREBRI_ACTUATE_SOUND
module-str = actuate_sound
source "subsys/logging/Kconfig.template.log_config"

endif #CEREBRI_ACTUATE_SOUND
```

## lib/actuate/status_led/Kconfig
```kconfig
# Copyright (c) 2023, CogniPilot Foundation
# SPDX-License-Identifier: Apache-2.0

menuconfig CEREBRI_ACTUATE_STATUS_LED
  bool "STATUS LED"
  help
    This option enables the status LED

if CEREBRI_ACTUATE_STATUS_LED

module = CEREBRI_ACTUATE_STATUS_LED
module-str = actuate_status_led
source "subsys/logging/Kconfig.template.log_config"

endif #CEREBRI_ACTUATE_STATUS_LED
```

## lib/actuate/vesc_can/Kconfig
```kconfig
# Copyright (c) 2023, CogniPilot Foundation
# SPDX-License-Identifier: Apache-2.0

rsource "../../synapse/vesc_can/Kconfig"

if VESC_CAN

module = ACTUATE_VESC_CAN
module-str = actuate_vesc_can
source "subsys/logging/Kconfig.template.log_config"

endif # VESC_CAN
```
