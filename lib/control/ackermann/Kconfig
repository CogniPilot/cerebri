## lib/control/ackermann/Kconfig
```kconfig
# Copyright (c) 2023, CogniPilot Foundation
# SPDX-License-Identifier: Apache-2.0

menuconfig CEREBRI_CONTROL_ACKERMANN
  bool "ackermann"
  depends on CEREBRI_SYNAPSE_ZBUS
  help
    This option enables the rover ackermamnn lib.

if CEREBRI_CONTROL_ACKERMANN

config CEREBRI_CONTROL_ACKERMANN_GAIN_HEADING
  int "heading gain"
  default 100
  help
    Steering = Heading error * GAIN_/ 1000

config CEREBRI_CONTROL_ACKERMANN_GAIN_CROSS_TRACK
  int "cross track gain"
  default 100
  help
    Steering = Cross track error * GAIN / 1000

config CEREBRI_CONTROL_ACKERMANN_GAIN_ALONG_TRACK
  int "along track gain"
  default 100
  help
    Steering = Along track error * GAIN / 1000

config CEREBRI_CONTROL_ACKERMANN_MAX_TURN_ANGLE_MRAD
  int "max turn angle mrad"
  default 400
  help
    Max turn angle in milli-radians

config CEREBRI_CONTROL_ACKERMANN_MAX_VELOCITY_MM_S
  int "max velocity, mm/s"
  default 22000
  help
    Max velocity in mm/s

config CEREBRI_CONTROL_ACKERMANN_WHEEL_RADIUS_MM
  int "wheel radius, mm"
  default 37
  help
    Wheel radius in mm

config CEREBRI_CONTROL_ACKERMANN_WHEEL_BASE_MM
  int "wheel base, mm"
  default 226
  help
    Wheel radius in mm

config BUGGY3_MOTOR_ENB_REQUIRED
  bool "Buggy3 motor ENB line required"
  help
    Set the enable line for the Buggy3 motor
    using normalized actuator message.

module = CEREBRI_CONTROL_ACKERMANN
module-str = control_ackermann
source "subsys/logging/Kconfig.template.log_config"

endif  # CEREBRI_CONTROL_ACKERMANN
```

## lib/control/diffdrive/Kconfig
```kconfig
# Copyright (c) 2023, CogniPilot Foundation
# SPDX-License-Identifier: Apache-2.0

menuconfig CEREBRI_CONTROL_DIFFDRIVE
  bool "diffdrive"
  depends on CEREBRI_SYNAPSE_ZBUS
  help
    This option enables the rover diffdrive lib.

if CEREBRI_CONTROL_DIFFDRIVE

config CEREBRI_CONTROL_DIFFDRIVE_BATTERY_MIN_MILLIVOLT
  int "min battery voltage in milli volts before shut off"
  default 35000
  help
    Minimum battery voltage in mV before auto-disarm

config CEREBRI_CONTROL_DIFFDRIVE_GAIN_HEADING
  int "heading gain"
  default 800
  help
    Steering = Heading error * GAIN_/ 1000

config CEREBRI_CONTROL_DIFFDRIVE_GAIN_CROSS_TRACK
  int "cross track gain"
  default 1000
  help
    Steering = Cross track error * GAIN / 1000

config CEREBRI_CONTROL_DIFFDRIVE_GAIN_ALONG_TRACK
  int "along track gain"
  default 1000
  help
    Steering = Along track error * GAIN / 1000

config CEREBRI_CONTROL_DIFFDRIVE_MAX_VELOCITY_MM_S
  int "max velocity, mm/s"
  default 1000
  help
    Max velocity in mm/s

config CEREBRI_CONTROL_DIFFDRIVE_WHEEL_RADIUS_MM
  int "wheel radius, mm"
  default 108
  help
    Wheel radius in mm

config CEREBRI_CONTROL_DIFFDRIVE_WHEEL_BASE_MM
  int "wheel base, mm"
  default 667
  help
    Wheel radius in mm

config CEREBRI_CONTROL_DIFFDRIVE_WHEEL_SEPARATION_MM
  int "wheel separation, mm"
  default 667
  help
    Wheel separation in mm

config CEREBRI_CONTROL_DIFFDRIVE_MAX_ANGULAR_VELOCITY_MRAD_S
  int "max turn rate, mrad/s"
  default 1000
  help
    Max turn rate mrad/s

module = CEREBRI_CONTROL_DIFFDRIVE
module-str = control_diffdrive
source "subsys/logging/Kconfig.template.log_config"

endif  # CEREBRI_CONTROL_DIFFDRIVE
```

## lib/control_ackermann/Kconfig
```kconfig
# Copyright (c) 2023, CogniPilot Foundation
# SPDX-License-Identifier: Apache-2.0

config CONTROL_ACKERMANN
  bool "rover ackermann control lib"
  help
    This option enables the rover ackermamnn lib.
```

## lib/control_rover/Kconfig
```kconfig
# Copyright (c) 2023, CogniPilot Foundation
# SPDX-License-Identifier: Apache-2.0

config CONTROL_ROVER
  bool "rover control lib"
  help
    This option enables the rover control lib.

config CONTROL_ROVER_STEERING_ACKERMANN
  bool "ackermann steering"
  help
    This option enables ackermann steering

config CONTROL_ROVER_STEERING_DIFFERENTIAL
  bool "differential steering"
  help
    This option enables differential steering
```

## lib/core/Kconfig
```kconfig
# Copyright (c) 2023 CogniPilot Foundation
# SPDX-License-Identifier: Apache-2.0

menu "Core"

rsource "workqueues/Kconfig"
rsource "common/Kconfig"

endmenu
```

## lib/core/common/Kconfig
```kconfig
# Copyright (c) 2023, CogniPilot Foundation
# SPDX-License-Identifier: Apache-2.0
menuconfig CEREBRI_CORE_COMMON
  bool "Enable core common"
  select ZROS_PERF
  default y
  help
     This option enables the core common library

if CEREBRI_CORE_COMMON

config CEREBRI_CORE_COMMON_BOOT_BANNER
  bool "Enable the boot banner"
  help
    Enable the boot banner

module = CEREBRI_CORE_COMMON
module-str = core_common
source "subsys/logging/Kconfig.template.log_config"

endif # CEREBRI_CORE_COMMON
```

## lib/core/workqueues/Kconfig
```kconfig
# Copyright (c) 2023, CogniPilot Foundation
# SPDX-License-Identifier: Apache-2.0
menuconfig CEREBRI_CORE_WORKQUEUES
  bool "Enable core work queues"
  default y
  help
    This option enables the system work queues

if CEREBRI_CORE_WORKQUEUES

module = CEREBRI_CORE_WORKQUEUES
module-str = core_workqueues
source "subsys/logging/Kconfig.template.log_config"

endif # CEREBRI_CORE_WORKQUEUES
```

## lib/dream/Kconfig
```kconfig
# Copyright (c) 2023 CogniPilot Foundation
# SPDX-License-Identifier: Apache-2.0

menu "Dream"

rsource "sitl/Kconfig"

endmenu
```

## lib/dream/sitl/Kconfig
```kconfig
# Copyright (c) 2023, CogniPilot Foundation
# SPDX-License-Identifier: Apache-2.0

menuconfig CEREBRI_DREAM_SITL
  bool "SITL"
  depends on CEREBRI_SYNAPSE_ZBUS
  help
    This option enables the cerebri sitl sim

if CEREBRI_DREAM_SITL

module = CEREBRI_DREAM_SITL
module-str = dream_sitl
source "subsys/logging/Kconfig.template.log_config"

endif  # CEREBRI_DREAM_SITL
```

## lib/estimate/Kconfig
```kconfig
# Copyright (c) 2023 CogniPilot Foundation
# SPDX-License-Identifier: Apache-2.0

menu "Estimate"

rsource "attitude/Kconfig"
rsource "rover2d/Kconfig"

endmenu
```

## lib/estimate/attitude/Kconfig
```kconfig
# Copyright (c) 2023, CogniPilot Foundation
# SPDX-License-Identifier: Apache-2.0

menuconfig CEREBRI_ESTIMATE_ATTITUDE
  bool "attitude"
  help
    This option enables the attitude estimator

if CEREBRI_ESTIMATE_ATTITUDE

module = CEREBRI_ESTIMATE_ATTITUDE
module-str = estimate_attitude
source "subsys/logging/Kconfig.template.log_config"

endif # CEREBRI_ESTIMATE_ATTITUDE
```

## lib/estimate/iekf/Kconfig
```kconfig
# Copyright (c) 2023, CogniPilot Foundation
# SPDX-License-Identifier: Apache-2.0

config ESTIMATE_IEKF
  bool "iekf estimator"
  help
    This option enables the iekf estimator

if ESTIMATE_IEKF

endif  #ESTIMATE_IEKF
```

## lib/estimate/rover2d/Kconfig
```kconfig
# Copyright (c) 2023, CogniPilot Foundation
# SPDX-License-Identifier: Apache-2.0

menuconfig CEREBRI_ESTIMATE_ROVER2D
  bool "rover2d"
  depends on CEREBRI_SYNAPSE_ZBUS
  help
    This option enables the rover2d estimator

if CEREBRI_ESTIMATE_ROVER2D

config CEREBRI_ESTIMATE_ROVER2D_WHEEL_RADIUS_MM
  int "wheel radius, mm"
  default 37
  help
    Wheel radius in mm

module = CEREBRI_ESTIMATE_ROVER2D
module-str = estimate_rover2d
source "subsys/logging/Kconfig.template.log_config"

endif # CEREBRI_ESTIMATE_ROVER2D
```

## lib/protobuf_uart/Kconfig
```kconfig
# Copyright (c) 2023, CogniPilot Foundation
# SPDX-License-Identifier: Apache-2.0

config PROTOBUF_UART
	bool "protobuf uart support"
	help
	  This option enables the the protobuf uart library
	depends on CONFIG_SERIAL
	depends on CONFIG_NANOPB
	depends on CONFIG_TINYFRAME
	depends on CONFIG_SYNAPSE_PB
```

## lib/sense/Kconfig
```kconfig
# Copyright (c) 2023 CogniPilot Foundation
# SPDX-License-Identifier: Apache-2.0

menu "Sense"

rsource "baro/Kconfig"
rsource "imu/Kconfig"
rsource "input/Kconfig"
rsource "mag/Kconfig"
rsource "power/Kconfig"
rsource "safety/Kconfig"
rsource "ubx_gnss/Kconfig"
rsource "vesc_can_status/Kconfig"
rsource "wheel_odometry/Kconfig"

endmenu
```

## lib/sense/baro/Kconfig
```kconfig
# Copyright (c) 2023, CogniPilot Foundation
# SPDX-License-Identifier: Apache-2.0
menuconfig CEREBRI_SENSE_BARO
  bool "Baro"
  help
    This option enables the barometric altimeter driver interface

if CEREBRI_SENSE_BARO

config CEREBRI_SENSE_BARO_COUNT
  int "Number of barometers"
  default 1
  range 1 4
  help
    Defines number of barometers 1-4

module = CEREBRI_SENSE_BARO
module-str = sense_baro
source "subsys/logging/Kconfig.template.log_config"

endif # CEREBRI_SENSE_BARO
```

## lib/sense/icm42688/Kconfig
```kconfig
# Copyright (c) 2023, CogniPilot Foundation
# SPDX-License-Identifier: Apache-2.0
menuconfig CEREBRI_SENSE_ICM42688
  bool "ICM42688"
  depends on CEREBRI_CORE_COMMON
  depends on ZROS
  help
    This option enables the ICM42688 driver interface

if CEREBRI_SENSE_ICM42688

module = CEREBRI_SENSE_ICM42688
module-str = sense_accel
source "subsys/logging/Kconfig.template.log_config"

endif # CEREBRI_SENSE_ICM42688
```

## lib/sense/imu/Kconfig
```kconfig
# Copyright (c) 2023, CogniPilot Foundation
# SPDX-License-Identifier: Apache-2.0
menuconfig CEREBRI_SENSE_IMU
  bool "IMU"
  default y
  depends on CEREBRI_CORE_COMMON
  depends on CEREBRI_SYNAPSE_ZROS
  help
    This option enables the IMU driver interface

if CEREBRI_SENSE_IMU

config CEREBRI_SENSE_IMU_ACCEL_COUNT
  int "Number of accelerometers"
  default 1
  range 1 4
  help
    Defines number of accelerometers 1-4

config CEREBRI_SENSE_IMU_GYRO_COUNT
  int "Number of gyroscopes"
  default 1
  range 1 4
  help
    Defines number of gyroscopes 1-4

module = CEREBRI_SENSE_IMU
module-str = sense_imu
source "subsys/logging/Kconfig.template.log_config"

endif # CEREBRI_SENSE_IMU
```

## lib/sense/joy/Kconfig
```kconfig
# Copyright (c) 2023, CogniPilot Foundation
# SPDX-License-Identifier: Apache-2.0
menuconfig CEREBRI_SENSE_JOY
  bool "Joy"
  default y
  depends on ZROS
  depends on CEREBRI_CORE_WORKQUEUES
  help
    This option enables the safety interface

if CEREBRI_SENSE_JOY

module = CEREBRI_SENSE_JOY
module-str = sense_safety
source "subsys/logging/Kconfig.template.log_config"

endif # CEREBRI_SENSE_JOY
```

## lib/sense/mag/Kconfig
```kconfig
# Copyright (c) 2023, CogniPilot Foundation
# SPDX-License-Identifier: Apache-2.0
menuconfig CEREBRI_SENSE_MAG
  bool "MAG"
  default y
  depends on CEREBRI_CORE_COMMON
  depends on CEREBRI_SYNAPSE_ZBUS
  help
    This option enables the MAG driver interface

if CEREBRI_SENSE_MAG

module = CEREBRI_SENSE_MAG
module-str = sense_mag
source "subsys/logging/Kconfig.template.log_config"

endif # CEREBRI_SENSE_MAG
```

## lib/sense/power/Kconfig
```kconfig
# Copyright (c) 2023, CogniPilot Foundation
# SPDX-License-Identifier: Apache-2.0

menuconfig CEREBRI_SENSE_POWER
  bool "Power"
  depends on CEREBRI_SYNAPSE_ZROS
  help
    This option enables power sensor.

if CEREBRI_SENSE_POWER

module = CEREBRI_SENSE_POWER
module-str = sense_power
source "subsys/logging/Kconfig.template.log_config"

endif # CEREBRI_SENSE_POWER
```

## lib/sense/safety/Kconfig
```kconfig
# Copyright (c) 2023, CogniPilot Foundation
# SPDX-License-Identifier: Apache-2.0
menuconfig CEREBRI_SENSE_SAFETY
  bool "Safety"
  default y
  depends on CEREBRI_SYNAPSE_ZBUS
  depends on CEREBRI_CORE_WORK_QUEUES
  help
    This option enables the safety interface

if CEREBRI_SENSE_SAFETY

module = CEREBRI_SENSE_SAFETY
module-str = sense_safety
source "subsys/logging/Kconfig.template.log_config"

endif # CEREBRI_SENSE_SAFETY
```

## lib/sense/sbus/Kconfig
```kconfig
# Copyright (c) 2023, CogniPilot Foundation
# SPDX-License-Identifier: Apache-2.0
menuconfig CEREBRI_SENSE_SBUS
  bool "Input"
  default y
  depends on ZROS
  depends on CEREBRI_CORE_WORKQUEUES
  help
    This option enables the safety interface

if CEREBRI_SENSE_SBUS

module = CEREBRI_SENSE_SBUS
module-str = sense_sbus
source "subsys/logging/Kconfig.template.log_config"

endif # CEREBRI_SENSE_SBUS
```

## lib/sense/ubx_gnss/Kconfig
```kconfig
# Copyright (c) 2023 CogniPilot Foundation
# SPDX-License-Identifier: Apache-2.0

config CEREBRI_SENSE_UBX_GNSS
  bool "U-blox GNSS Interface"
  depends on ZROS
  depends on UBXLIB
  help
    This option enables U-blox GNSS driver.

if CEREBRI_SENSE_UBX_GNSS

choice
     prompt "Select U-blox GNSS module type."
     default CEREBRI_SENSE_UBX_GNSS_MODULE_TYPE_M10

config CEREBRI_SENSE_UBX_GNSS_MODULE_TYPE_M10
     bool "CEREBRI_SENSE_UBX_GNSS_MODULE_TYPE_M10"

config CEREBRI_SENSE_UBX_GNSS_MODULE_TYPE_M9
     bool "CEREBRI_SENSE_UBX_GNSS_MODULE_TYPE_M9"

config CEREBRI_SENSE_UBX_GNSS_MODULE_TYPE_M8
     bool "CEREBRI_SENSE_UBX_GNSS_MODULE_TYPE_M8"

endchoice

config CEREBRI_SENSE_UBX_GNSS_BAUD
  int  "U-blox GNSS Baud Rate"
  default 115200
  help
    This sets the baud rate for the U-blox GNSS driver [38400,115200].

module = CEREBRI_SENSE_UBX_GNSS
module-str = sense_ubx_gnss
source "subsys/logging/Kconfig.template.log_config"

endif # CEREBRI_SENSE_UBX_GNSS
```

## lib/sense/wheel_odometry/Kconfig
```kconfig
# Copyright (c) 2023, CogniPilot Foundation
# SPDX-License-Identifier: Apache-2.0
menuconfig SENSE_WHEEL_ODOMETRY
  bool "Use wheel odometry"
  default n
  help
    This option enables the wheel odometry driver interface

if SENSE_WHEEL_ODOMETRY

module = SENSE_WHEEL_ODOMETRY
module-str = sense_wheel_odometry
source "subsys/logging/Kconfig.template.log_config"

endif # SENSE_WHEEL_ODOMETRY
```
