## lib/simulate/sitl/Kconfig
```kconfig
# Copyright (c) 2023, CogniPilot Foundation
# SPDX-License-Identifier: Apache-2.0

config SIM_SITL
  bool "enable sitl simulation"
  help
    This option enables the cerebri sitl sim

if SIM_SITL

endif  # SIM_SITL
```

## lib/synapse/Kconfig
```kconfig
# Copyright (c) 2023 CogniPilot Foundation
# SPDX-License-Identifier: Apache-2.0

menu "Synapse"

rsource "eth_rx/Kconfig"
rsource "eth_tx/Kconfig"
rsource "sdcard/Kconfig"
rsource "topic/Kconfig"
rsource "vesc_can/Kconfig"

endmenu
```

## lib/synapse/can/Kconfig
```kconfig
# Copyright (c) 2023, CogniPilot Foundation
# SPDX-License-Identifier: Apache-2.0

config SYNAPSE_CAN
  bool "synapse can communication"
  help
    This option enables synapse can communicate node

if SYNAPSE_CAN

endif  # SYNAPSE_CAN
```

## lib/synapse/eth_rx/Kconfig
```kconfig
# Copyright (c) 2024, CogniPilot Foundation
# SPDX-License-Identifier: Apache-2.0

config CEREBRI_SYNAPSE_ETH_RX
  bool "ethernet receive"	
  default y
  depends on CEREBRI_SYNAPSE_ZROS
  help
    This option enables the synapse udp interface

if CEREBRI_SYNAPSE_ETH_RX

module = CEREBRI_SYNAPSE_ETH_RX
module-str = synapse_eth_rx
source "subsys/logging/Kconfig.template.log_config"

endif # CEREBRI_SYNAPSE_ETH_RX
```

## lib/synapse/ethernet/Kconfig
```kconfig
# Copyright (c) 2023, CogniPilot Foundation
# SPDX-License-Identifier: Apache-2.0

config CEREBRI_SYNAPSE_ETHERNET
  bool "Ethernet"
  default y
  depends on CEREBRI_SYNAPSE_ZBUS
  help
    This option enables the synapse ethernet interface

if CEREBRI_SYNAPSE_ETHERNET

module = CEREBRI_SYNAPSE_ETHERNET
module-str = synapse_ethernet
source "subsys/logging/Kconfig.template.log_config"

endif # CEREBRI_SYNAPSE_ETHERNET
```

## lib/synapse/sdcard/Kconfig
```kconfig
# Copyright (c) 2024, CogniPilot Foundation
# SPDX-License-Identifier: Apache-2.0

config CEREBRI_SYNAPSE_SDCARD
  bool "sdcard logging"	
  default y
  depends on ZROS
  help
    This option enables the synapse udp interface

if CEREBRI_SYNAPSE_SDCARD

module = CEREBRI_SYNAPSE_SDCARD
module-str = synapse_sdcard
source "subsys/logging/Kconfig.template.log_config"

endif # CEREBRI_SYNAPSE_SDCARD
```

## lib/synapse/topic/Kconfig
```kconfig
# Copyright (c) 2023, CogniPilot Foundation
# SPDX-License-Identifier: Apache-2.0

config CEREBRI_SYNAPSE_TOPIC
  bool "Enable synapse topic shell"
  default y
  depends on CEREBRI_SYNAPSE_ZBUS
  depends on SHELL
  help
    This option enables the synapse topic shell

if CEREBRI_SYNAPSE_TOPIC

module = CEREBRI_SYNAPSE_TOPIC
module-str = synapse_topic
source "subsys/logging/Kconfig.template.log_config"

endif  # CEREBRI_SYNAPSE_TOPIC
```

## lib/synapse/uart/Kconfig
```kconfig
# Copyright (c) 2023, CogniPilot Foundation
# SPDX-License-Identifier: Apache-2.0

menuconfig SYNAPSE_UART
  bool "UART"
  help
    This option enables the synapse uart interface

if SYNAPSE_UART

module = SYNAPSE_UART
module-str = synapse_uart
source "subsys/logging/Kconfig.template.log_config"

endif  # SYNAPSE_UART
```
