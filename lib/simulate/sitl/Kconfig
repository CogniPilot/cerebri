## lib/synapse/vesc_can/Kconfig
```kconfig
# Copyright (c) 2023, CogniPilot Foundation
# SPDX-License-Identifier: Apache-2.0

menuconfig CEREBRI_SYNAPSE_VESC_CAN
  bool "VESC CAN"
  depends on CAN
  help
    This option enables configuring VESC CAN

if CEREBRI_SYNAPSE_VESC_CAN

config CEREBRI_SYNAPSE_VESC_CAN_STATUS
  bool "VESC CAN based status"
  depends on CAN
  help
    This option enables status messages for CAN VESC

config CEREBRI_SYNAPSE_VESC_CAN_NUMBER
  int "Number of VESC CAN actuators"
  default 1
  range 1 8
  depends on CEREBRI_ACTUATE_VESC_CAN || CEREBRI_SYNAPSE_VESC_CAN_STATUS
  help
    Defines number of CEREBRI_SYNAPSE_VESC CAN actuators 1-8

if CEREBRI_ACTUATE_VESC_CAN || CEREBRI_SYNAPSE_VESC_CAN_STATUS
menu "CEREBRI_SYNAPSE_VESC_CAN_0"

config CEREBRI_SYNAPSE_VESC_CAN_BUS_ALIAS_CAN_N_0
  int "CAN bus alias CAN# for CEREBRI_SYNAPSE_VESC 0"
  default 0
  depends on CEREBRI_ACTUATE_VESC_CAN || CEREBRI_SYNAPSE_VESC_CAN_STATUS
  help
    CAN bus device alias name can(number) that connects to CEREBRI_SYNAPSE_VESC 0.

config CEREBRI_SYNAPSE_VESC_CAN_BUS_FD_0
  bool "CAN bus is CANFD for CEREBRI_SYNAPSE_VESC 0"
  depends on CEREBRI_ACTUATE_VESC_CAN || CEREBRI_SYNAPSE_VESC_CAN_STATUS
  depends on CAN_FD_MODE
  help
    This option sets the CAN bus to use CANFD for 
    device bus

config CEREBRI_SYNAPSE_VESC_POLE_PAIR_0
  int "Number of Pole Pairs of motor attached to CEREBRI_SYNAPSE_VESC 0"
  default 15
  range 1 128
  depends on CEREBRI_ACTUATE_VESC_CAN || CEREBRI_SYNAPSE_VESC_CAN_STATUS
  help
    Number of Pole Pairs of motor attached to CEREBRI_SYNAPSE_VESC 0.

config CEREBRI_SYNAPSE_VESC_CAN_ID_0
  int "ID of CEREBRI_SYNAPSE_VESC 0"
  default 0
  range 0 255
  depends on CEREBRI_ACTUATE_VESC_CAN || CEREBRI_SYNAPSE_VESC_CAN_STATUS
  help
    ID assigned to CEREBRI_SYNAPSE_VESC 0.

config CEREBRI_SYNAPSE_VESC_CAN_ACTUATOR_VEL_IDX_0
  int "Actuator velocity index for CEREBRI_SYNAPSE_VESC 0"
  default 0
  range 0 15
  depends on CEREBRI_ACTUATE_VESC_CAN
  help
    Actuator velocity index for CEREBRI_SYNAPSE_VESC 0.

config CEREBRI_SYNAPSE_VESC_STATUS_BITMASK_0
  int "bitmask for CEREBRI_SYNAPSE_VESC status message subscription"
  default 1
  range 0 63
  depends on CEREBRI_SYNAPSE_VESC_CAN_STATUS
  help
    bitmask for CEREBRI_SYNAPSE_VESC CAN status messages [ STAT6 STAT5 STAT4 STAT3 STAT2 STAT1 ]
    IE setting status message 4 and 1 would be 0b001001 = 9
    If no status desired set to 0 for it to skip

endmenu

endif

if CEREBRI_SYNAPSE_VESC_CAN_NUMBER > 1

menu "CEREBRI_SYNAPSE_VESC_CAN_1"

config CEREBRI_SYNAPSE_VESC_CAN_BUS_ALIAS_CAN_N_1
  int "CAN bus alias CAN# for CEREBRI_SYNAPSE_VESC 1"
  default 0
  depends on CEREBRI_ACTUATE_VESC_CAN || CEREBRI_SYNAPSE_VESC_CAN_STATUS
  help
    CAN bus device alias name can(number) that connects to CEREBRI_SYNAPSE_VESC 1.

config CEREBRI_SYNAPSE_VESC_CAN_BUS_FD_1
  bool "CAN bus is CANFD for CEREBRI_SYNAPSE_VESC 1"
  depends on CEREBRI_ACTUATE_VESC_CAN || CEREBRI_SYNAPSE_VESC_CAN_STATUS
  depends on CAN_FD_MODE
  help
    This option sets the CAN bus to use CANFD for 
    device bus

config CEREBRI_SYNAPSE_VESC_POLE_PAIR_1
  int "Number of Pole Pairs of motor attached to CEREBRI_SYNAPSE_VESC 1"
  default 15
  range 1 128
  depends on CEREBRI_ACTUATE_VESC_CAN || CEREBRI_SYNAPSE_VESC_CAN_STATUS
  help
    Number of Pole Pairs of motor attached to CEREBRI_SYNAPSE_VESC 1.

config CEREBRI_SYNAPSE_VESC_CAN_ID_1
  int "ID of CEREBRI_SYNAPSE_VESC 1"
  default 1
  range 0 255
  depends on CEREBRI_ACTUATE_VESC_CAN || CEREBRI_SYNAPSE_VESC_CAN_STATUS
  help
    ID assigned to CEREBRI_SYNAPSE_VESC 1.

config CEREBRI_SYNAPSE_VESC_CAN_ACTUATOR_VEL_IDX_1
  int "Actuator velocity index for CEREBRI_SYNAPSE_VESC 1"
  default 1
  range 0 15
  depends on CEREBRI_ACTUATE_VESC_CAN
  help
    Actuator velocity index for CEREBRI_SYNAPSE_VESC 1.

config CEREBRI_SYNAPSE_VESC_STATUS_BITMASK_1
  int "bitmask for CEREBRI_SYNAPSE_VESC status message subscription"
  default 1
  range 0 63
  depends on CEREBRI_SYNAPSE_VESC_CAN_STATUS
  help
    bitmask for CEREBRI_SYNAPSE_VESC CAN 1 status messages [ STAT6 STAT5 STAT4 STAT3 STAT2 STAT1 ]
    IE setting status message 4 and 1 would be 0b001001 = 9
    If no status desired set to 0 for it to skip

endmenu

endif # CEREBRI_SYNAPSE_VESC_CAN_NUMBER > 1

if CEREBRI_SYNAPSE_VESC_CAN_NUMBER > 2

menu "CEREBRI_SYNAPSE_VESC_CAN_2"

config CEREBRI_SYNAPSE_VESC_CAN_BUS_ALIAS_CAN_N_2
  int "CAN bus alias CAN# for CEREBRI_SYNAPSE_VESC 2"
  default 0
  depends on CEREBRI_ACTUATE_VESC_CAN || CEREBRI_SYNAPSE_VESC_CAN_STATUS
  help
    CAN bus device alias name can(number) that connects to CEREBRI_SYNAPSE_VESC 2.

config CEREBRI_SYNAPSE_VESC_CAN_BUS_FD_2
  bool "CAN bus is CANFD for CEREBRI_SYNAPSE_VESC 2"
  depends on CEREBRI_ACTUATE_VESC_CAN || CEREBRI_SYNAPSE_VESC_CAN_STATUS
  depends on CAN_FD_MODE
  help
    This option sets the CAN bus to use CANFD for 
    device bus

config CEREBRI_SYNAPSE_VESC_POLE_PAIR_2
  int "Number of Pole Pairs of motor attached to CEREBRI_SYNAPSE_VESC 2"
  default 15
  range 1 128
  depends on CEREBRI_ACTUATE_SYNAPSE_VESC_CAN || CEREBRI_SYNAPSE_VESC_CAN_STATUS
  help
    Number of Pole Pairs of motor attached to CEREBRI_SYNAPSE_VESC 2.

config CEREBRI_SYNAPSE_VESC_CAN_ID_2
  int "ID of CEREBRI_SYNAPSE_VESC 2"
  default 2
  range 0 255
  depends on CEREBRI_ACTUATE_VESC_CAN || CEREBRI_SYNAPSE_VESC_CAN_STATUS
  help
    ID assigned to CEREBRI_SYNAPSE_VESC 2.

config CEREBRI_SYNAPSE_VESC_CAN_ACTUATOR_VEL_IDX_2
  int "Actuator velocity index for CEREBRI_SYNAPSE_VESC 2"
  default 2
  range 0 15
  depends on CEREBRI_ACTUATE_SYNAPSE_VESC_CAN
  help
    Actuator velocity index for CEREBRI_SYNAPSE_VESC 2.

config CEREBRI_SYNAPSE_VESC_STATUS_BITMASK_2
  int "bitmask for CEREBRI_SYNAPSE_VESC status message subscription"
  default 1
  range 0 63
  depends on CEREBRI_SYNAPSE_VESC_CAN_STATUS
  help
    bitmask for CEREBRI_SYNAPSE_VESC CAN 2 status messages [ STAT6 STAT5 STAT4 STAT3 STAT2 STAT1 ]
    IE setting status message 4 and 1 would be 0b001001 = 9
    If no status desired set to 0 for it to skip

endmenu

endif # CEREBRI_SYNAPSE_VESC_CAN_NUMBER > 2

if CEREBRI_SYNAPSE_VESC_CAN_NUMBER > 3

menu "CEREBRI_SYNAPSE_VESC_CAN_3"

config CEREBRI_SYNAPSE_VESC_CAN_BUS_ALIAS_CAN_N_3
  int "CAN bus alias CAN# for CEREBRI_SYNAPSE_VESC 3"
  default 0
  depends on CEREBRI_ACTUATE_SYNAPSE_VESC_CAN || CEREBRI_SYNAPSE_VESC_CAN_STATUS
  help
    CAN bus device alias name can(number) that connects to CEREBRI_SYNAPSE_VESC 3.

config CEREBRI_SYNAPSE_VESC_CAN_BUS_FD_3
  bool "CAN bus is CANFD for CEREBRI_SYNAPSE_VESC 3"
  depends on CEREBRI_ACTUATE_VESC_CAN || CEREBRI_SYNAPSE_VESC_CAN_STATUS
  depends on CAN_FD_MODE
  help
    This option sets the CAN bus to use CANFD for 
    device bus

config CEREBRI_SYNAPSE_VESC_POLE_PAIR_3
  int "Number of Pole Pairs of motor attached to CEREBRI_SYNAPSE_VESC 3"
  default 15
  range 1 128
  depends on CEREBRI_ACTUATE_SYNAPSE_VESC_CAN || CEREBRI_SYNAPSE_VESC_CAN_STATUS
  help
    Number of Pole Pairs of motor attached to CEREBRI_SYNAPSE_VESC 3.

config CEREBRI_SYNAPSE_VESC_CAN_ID_2
  int "ID of CEREBRI_SYNAPSE_VESC 3"
  default 3
  range 0 255
  depends on CEREBRI_ACTUATE_SYNAPSE_VESC_CAN || CEREBRI_SYNAPSE_VESC_CAN_STATUS
  help
    ID assigned to CEREBRI_SYNAPSE_VESC 3.

config CEREBRI_SYNAPSE_VESC_CAN_ACTUATOR_VEL_IDX_3
  int "Actuator velocity index for CEREBRI_SYNAPSE_VESC 3"
  default 3
  range 0 15
  depends on CEREBRI_ACTUATE_SYNAPSE_VESC_CAN
  help
    Actuator velocity index for CEREBRI_SYNAPSE_VESC 3.

config CEREBRI_SYNAPSE_VESC_STATUS_BITMASK_3
  int "bitmask for CEREBRI_SYNAPSE_VESC status message subscription"
  default 1
  range 0 63
  depends on CEREBRI_SYNAPSE_VESC_CAN_STATUS
  help
    bitmask for CEREBRI_SYNAPSE_VESC CAN 3 status messages [ STAT6 STAT5 STAT4 STAT3 STAT2 STAT1 ]
    IE setting status message 4 and 1 would be 0b001001 = 9
    If no status desired set to 0 for it to skip

endmenu

endif # CEREBRI_SYNAPSE_VESC_CAN_NUMBER > 3

if CEREBRI_SYNAPSE_VESC_CAN_NUMBER > 4

menu "CEREBRI_SYNAPSE_VESC_CAN_4"

config CEREBRI_SYNAPSE_VESC_CAN_BUS_ALIAS_CAN_N_4
  int "CAN bus alias CAN# for CEREBRI_SYNAPSE_VESC 4"
  default 0
  depends on CEREBRI_ACTUATE_VESC_CAN || CEREBRI_SYNAPSE_VESC_CAN_STATUS
  help
    CAN bus device alias name can(number) that connects to CEREBRI_SYNAPSE_VESC 4.

config CEREBRI_SYNAPSE_VESC_CAN_BUS_FD_4
  bool "CAN bus is CANFD for CEREBRI_SYNAPSE_VESC 4"
  depends on CEREBRI_ACTUATE_VESC_CAN || CEREBRI_SYNAPSE_VESC_CAN_STATUS
  depends on CAN_FD_MODE
  help
    This option sets the CAN bus to use CANFD for 
    device bus

config CEREBRI_SYNAPSE_VESC_POLE_PAIR_4
  int "Number of Pole Pairs of motor attached to CEREBRI_SYNAPSE_VESC 4"
  default 15
  range 1 128
  depends on CEREBRI_ACTUATE_VESC_CAN || CEREBRI_SYNAPSE_VESC_CAN_STATUS
  help
    Number of Pole Pairs of motor attached to CEREBRI_SYNAPSE_VESC 4.

config CEREBRI_SYNAPSE_VESC_CAN_ID_4
  int "ID of CEREBRI_SYNAPSE_VESC 4"
  default 4
  range 0 255
  depends on CEREBRI_ACTUATE_VESC_CAN || CEREBRI_SYNAPSE_VESC_CAN_STATUS
  help
    ID assigned to CEREBRI_SYNAPSE_VESC 4.

config CEREBRI_SYNAPSE_VESC_CAN_ACTUATOR_VEL_IDX_4
  int "Actuator velocity index for CEREBRI_SYNAPSE_VESC 4"
  default 4
  range 0 15
  depends on CEREBRI_ACTUATE_VESC_CAN
  help
    Actuator velocity index for CEREBRI_SYNAPSE_VESC 4.

config CEREBRI_SYNAPSE_VESC_STATUS_BITMASK_4
  int "bitmask for CEREBRI_SYNAPSE_VESC status message subscription"
  default 1
  range 0 63
  depends on CEREBRI_SYNAPSE_VESC_CAN_STATUS
  help
    bitmask for CEREBRI_SYNAPSE_VESC CAN 4 status messages [ STAT6 STAT5 STAT4 STAT3 STAT2 STAT1 ]
    IE setting status message 4 and 1 would be 0b001001 = 9
    If no status desired set to 0 for it to skip

endmenu

endif # CEREBRI_SYNAPSE_VESC_CAN_NUMBER > 4

if CEREBRI_SYNAPSE_VESC_CAN_NUMBER > 5

menu "CEREBRI_SYNAPSE_VESC_CAN_5"

config CEREBRI_SYNAPSE_VESC_CAN_BUS_ALIAS_CAN_N_5
  int "CAN bus alias CAN# for CEREBRI_SYNAPSE_VESC 5"
  default 0
  depends on CEREBRI_ACTUATE_VESC_CAN || CEREBRI_SYNAPSE_VESC_CAN_STATUS
  help
    CAN bus device alias name can(number) that connects to CEREBRI_SYNAPSE_VESC 5.

config CEREBRI_SYNAPSE_VESC_CAN_BUS_FD_5
  bool "CAN bus is CANFD for CEREBRI_SYNAPSE_VESC 5"
  depends on CEREBRI_ACTUATE_VESC_CAN || CEREBRI_SYNAPSE_VESC_CAN_STATUS
  depends on CAN_FD_MODE
  help
    This option sets the CAN bus to use CANFD for 
    device bus

config CEREBRI_SYNAPSE_VESC_POLE_PAIR_5
  int "Number of Pole Pairs of motor attached to CEREBRI_SYNAPSE_VESC 5"
  default 15
  range 1 128
  depends on CEREBRI_ACTUATE_VESC_CAN || CEREBRI_SYNAPSE_VESC_CAN_STATUS
  help
    Number of Pole Pairs of motor attached to CEREBRI_SYNAPSE_VESC 5.

config CEREBRI_SYNAPSE_VESC_CAN_ID_5
  int "ID of CEREBRI_SYNAPSE_VESC 5"
  default 5
  range 0 255
  depends on CEREBRI_ACTUATE_VESC_CAN || CEREBRI_SYNAPSE_VESC_CAN_STATUS
  help
    ID assigned to CEREBRI_SYNAPSE_VESC 5.

config CEREBRI_SYNAPSE_VESC_CAN_ACTUATOR_VEL_IDX_5
  int "Actuator velocity index for CEREBRI_SYNAPSE_VESC 5"
  default 5
  range 0 15
  depends on CEREBRI_ACTUATE_VESC_CAN
  help
    Actuator velocity index for CEREBRI_SYNAPSE_VESC 5.

config CEREBRI_SYNAPSE_VESC_STATUS_BITMASK_5
  int "bitmask for CEREBRI_SYNAPSE_VESC status message subscription"
  default 1
  range 0 63
  depends on CEREBRI_SYNAPSE_VESC_CAN_STATUS
  help
    bitmask for CEREBRI_SYNAPSE_VESC CAN 5 status messages [ STAT6 STAT5 STAT4 STAT3 STAT2 STAT1 ]
    IE setting status message 4 and 1 would be 0b001001 = 9
    If no status desired set to 0 for it to skip

endmenu

endif # CEREBRI_SYNAPSE_VESC_CAN_NUMBER > 5

if CEREBRI_SYNAPSE_VESC_CAN_NUMBER > 6

menu "CEREBRI_SYNAPSE_VESC_CAN_6"

config CEREBRI_SYNAPSE_VESC_CAN_BUS_ALIAS_CAN_N_6
  int "CAN bus alias CAN# for CEREBRI_SYNAPSE_VESC 6"
  default 0
  depends on CEREBRI_ACTUATE_VESC_CAN || CEREBRI_SYNAPSE_VESC_CAN_STATUS
  help
    CAN bus device alias name can(number) that connects to CEREBRI_SYNAPSE_VESC 6.

config CEREBRI_SYNAPSE_VESC_CAN_BUS_FD_6
  bool "CAN bus is CANFD for CEREBRI_SYNAPSE_VESC 6"
  depends on CEREBRI_ACTUATE_VESC_CAN || CEREBRI_SYNAPSE_VESC_CAN_STATUS
  depends on CAN_FD_MODE
  help
    This option sets the CAN bus to use CANFD for 
    device bus

config CEREBRI_SYNAPSE_VESC_POLE_PAIR_6
  int "Number of Pole Pairs of motor attached to CEREBRI_SYNAPSE_VESC 6"
  default 15
  range 1 128
  depends on CEREBRI_ACTUATE_VESC_CAN || CEREBRI_SYNAPSE_VESC_CAN_STATUS
  help
    Number of Pole Pairs of motor attached to CEREBRI_SYNAPSE_VESC 6.

config CEREBRI_SYNAPSE_VESC_CAN_ID_6
  int "ID of CEREBRI_SYNAPSE_VESC 6"
  default 6
  range 0 255
  depends on CEREBRI_ACTUATE_VESC_CAN || CEREBRI_SYNAPSE_VESC_CAN_STATUS
  help
    ID assigned to CEREBRI_SYNAPSE_VESC 6.

config CEREBRI_SYNAPSE_VESC_CAN_ACTUATOR_VEL_IDX_6
  int "Actuator velocity index for CEREBRI_SYNAPSE_VESC 6"
  default 6
  range 0 15
  depends on CEREBRI_ACTUATE_VESC_CAN
  help
    Actuator velocity index for CEREBRI_SYNAPSE_VESC 6.

config CEREBRI_SYNAPSE_VESC_STATUS_BITMASK_6
  int "bitmask for CEREBRI_SYNAPSE_VESC status message subscription"
  default 1
  range 0 63
  depends on CEREBRI_SYNAPSE_VESC_CAN_STATUS
  help
    bitmask for CEREBRI_SYNAPSE_VESC CAN 6 status messages [ STAT6 STAT5 STAT4 STAT3 STAT2 STAT1 ]
    IE setting status message 4 and 1 would be 0b001001 = 9
    If no status desired set to 0 for it to skip

endmenu

endif # CEREBRI_SYNAPSE_VESC_CAN_NUMBER > 6

if CEREBRI_SYNAPSE_VESC_CAN_NUMBER > 7

menu "CEREBRI_SYNAPSE_VESC_CAN_7"

config CEREBRI_SYNAPSE_VESC_CAN_BUS_ALIAS_CAN_N_7
  int "CAN bus alias CAN# for CEREBRI_SYNAPSE_VESC 7"
  default 0
  depends on CEREBRI_ACTUATE_VESC_CAN || CEREBRI_SYNAPSE_VESC_CAN_STATUS
  help
    CAN bus device alias name can(number) that connects to CEREBRI_SYNAPSE_VESC 7.

config CEREBRI_SYNAPSE_VESC_CAN_BUS_FD_7
  bool "CAN bus is CANFD for CEREBRI_SYNAPSE_VESC 7"
  depends on CEREBRI_ACTUATE_VESC_CAN || CEREBRI_SYNAPSE_VESC_CAN_STATUS
  depends on CAN_FD_MODE
  help
    This option sets the CAN bus to use CANFD for 
    device bus

config CEREBRI_SYNAPSE_VESC_POLE_PAIR_7
  int "Number of Pole Pairs of motor attached to CEREBRI_SYNAPSE_VESC 7"
  default 15
  range 1 128
  depends on CEREBRI_ACTUATE_VESC_CAN || CEREBRI_SYNAPSE_VESC_CAN_STATUS
  help
    Number of Pole Pairs of motor attached to CEREBRI_SYNAPSE_VESC 7.

config CEREBRI_SYNAPSE_VESC_CAN_ID_7
  int "ID of CEREBRI_SYNAPSE_VESC 7"
  default 7
  range 0 255
  depends on CEREBRI_ACTUATE_VESC_CAN || CEREBRI_SYNAPSE_VESC_CAN_STATUS
  help
    ID assigned to CEREBRI_SYNAPSE_VESC 7.

config CEREBRI_SYNAPSE_VESC_CAN_ACTUATOR_VEL_IDX_7
  int "Actuator velocity index for CEREBRI_SYNAPSE_VESC 7"
  default 7
  range 0 15
  depends on CEREBRI_ACTUATE_VESC_CAN
  help
    Actuator velocity index for CEREBRI_SYNAPSE_VESC 7.

config CEREBRI_SYNAPSE_VESC_STATUS_BITMASK_7
  int "bitmask for CEREBRI_SYNAPSE_VESC status message subscription"
  default 1
  range 0 63
  depends on CEREBRI_SYNAPSE_VESC_CAN_STATUS
  help
    bitmask for CEREBRI_SYNAPSE_VESC CAN 7 status messages [ STAT6 STAT5 STAT4 STAT3 STAT2 STAT1 ]
    IE setting status message 4 and 1 would be 0b001001 = 9
    If no status desired set to 0 for it to skip

endmenu

endif # CEREBRI_SYNAPSE_VESC_CAN_NUMBER > 7

endif # CEREBRI_ACTUATE_VESC_CAN
```

## lib/synapse/zbus/Kconfig
```kconfig
# Copyright (c) 2023, CogniPilot Foundation
# SPDX-License-Identifier: Apache-2.0

config CEREBRI_SYNAPSE_ZBUS
  bool "Enables zbus channels"
  default y
  depends on ZBUS
  depends on ZBUS_CHANNEL_NAME
  depends on ZBUS_OBSERVER_NAME
  depends on SYNAPSE_PROTOBUF
  depends on SYNAPSE_TINYFRAME
  depends on CEREBRI_CORE_COMMON
  help
    This option enables the synapse zbus channels

if CEREBRI_SYNAPSE_ZBUS

module = CEREBRI_SYNAPSE_ZBUS
module-str = synapse_zbus
source "subsys/logging/Kconfig.template.log_config"

endif  # CEREBRI_SYNAPSE_ZBUS
```
