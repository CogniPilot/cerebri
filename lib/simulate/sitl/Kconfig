## lib/synapse/zros/Kconfig
```kconfig
# Copyright (c) 2023, CogniPilot Foundation
# SPDX-License-Identifier: Apache-2.0

config CEREBRI_SYNAPSE_ZROS
  bool "Enables zros"
  help
    This option enables zros

if CEREBRI_SYNAPSE_ZROS

module = CEREBRI_SYNAPSE_ZROS
module-str = synapse_zros
source "subsys/logging/Kconfig.template.log_config"

endif  # CEREBRI_SYNAPSE_ZROS
```

## lib/synapse_pb/Kconfig
```kconfig
# Copyright (c) 2023, CogniPilot Foundation
# SPDX-License-Identifier: Apache-2.0

config SYNAPSE_PB
	bool "synapse protobuf backend"
	help
	  This option enables the synapse protobuf backend

if SYNAPSE_PB

config SYNAPSE_PB_UART
	bool "synapse protobuf uart thread"
	help
	  This option enables the synapse protobuf uart thread

config SYNAPSE_PB_ETHERNET
	bool "synapse protobuf uart thread"
	help
	  This option enables the synapse protobuf uart thread
        depends on NET

endif  # SYNAPSE_PB
```

## lib/synapse_zbus/Kconfig
```kconfig
# Copyright (c) 2023, CogniPilot Foundation
# SPDX-License-Identifier: Apache-2.0

config SYNAPSE_ZBUS
  bool "synapse zbus interface"
  help
    This option enables the synapse zbus interface

if SYNAPSE_ZBUS

config SYNAPSE_ZBUS_UART
  bool "synapse protobuf uart thread"
  help
    This option enables the synapse protobuf uart thread

config SYNAPSE_ZBUS_ETHERNET
  bool "synapse protobuf ethernet thread"
  help
    This option enables the synapse protobuf ethernet thread

endif  # SYNAPSE_ZBUS
```

## lib/synaptic_gap/Kconfig
```kconfig
# Copyright (c) 2023, CogniPilot Foundation
# SPDX-License-Identifier: Apache-2.0

config SYNAPTIC_GAP
  bool "synapse gap"
  help
    This option enables the synaptic gap that communicates with ROS

if SYNAPTIC_GAP

config SYNAPTIC_GAP_UART
  bool "synapse protobuf uart thread"
  help
    This option enables the synapse protobuf uart thread

config SYNAPTIC_GAP_ETHERNET
  bool "synapse protobuf ethernet thread"
  help
    This option enables the synapse protobuf ethernet thread

endif  # SYNAPTIC_GAP
```

## lib/vesc_can/vesc_can_status/Kconfig
```kconfig
# Copyright (c) 2023, CogniPilot Foundation
# SPDX-License-Identifier: Apache-2.0

rsource "lib/vesc_can/Kconfig"
```

## modules/sim_core/Kconfig
```kconfig
config CEREBRI_DRIVER_SIM_CORE
	bool "Gazebo Simulation Core"
	default y
	help
		This option enables the simulation core driver.
```

## modules/sim_gz/Kconfig
```kconfig
config CEREBRI_DRIVER_SIM_GZ
	bool "Gazebo Simulation"
	default y
	help
		This option enables the gazebo simulation driver.
```

## modules/tinyframe/Kconfig
```kconfig
# SPDX-License-Identifier: Apache-2.0
config TINYFRAME
        bool "TinyFrame Support"
        help
          This option enables the Tinyframe library.

if TINYFRAME

endif
```

## modules/zenoh-pico/Kconfig
```kconfig
config ZEPHYR_ZENOH_PICO_MODULE
	bool

menuconfig ZENOH_PICO
	bool "Zenopico Support"
	help
		This option enables the Zenopico library.

if ZENOH_PICO

endif # ZENOH_PICO
```

## rdd2/drivers/nxp_flexio_dshot/Kconfig
```kconfig
config RDD2_DSHOT
	bool "Enable RDD2 FlexIO DSHOT support"
	depends on DT_HAS_NXP_FLEXIO_ENABLED
	default y
	select MCUX_FLEXIO
	help
	  Select the Zephyr FlexIO support required by the local RDD2
	  DSHOT driver.
```

## rdd2/subsys/sitl/Kconfig
```kconfig
config RDD2_SITL
	bool "Enable native_sim software-in-the-loop support"
	depends on BOARD_NATIVE_SIM
	default y
	help
	  Enable the native_sim UDP transport and shared FlatBuffer staging used
	  by the fake RC, IMU, and DSHOT device adapters.

if RDD2_SITL

config RDD2_SITL_HOST
	string "SITL host IPv4 address"
	default "127.0.0.1"
	help
	  IPv4 address of the host process that receives outbound SITL topic
	  datagrams.

config RDD2_SITL_RX_PORT
	int "SITL input UDP port"
	range 1 65535
	default 4242
	help
	  UDP port on which native_sim receives FlatBuffer SimInput datagrams.

config RDD2_SITL_TX_FLIGHT_SNAPSHOT_PORT
	int "SITL flight state UDP port"
	range 1 65535
	default 4243
	help
	  UDP port to which native_sim publishes outbound flight-state blobs
	  encoded as FlightSnapshot.

config RDD2_SITL_TX_MOTOR_OUTPUT_PORT
	int "SITL motor output UDP port"
	range 1 65535
	default 4244
	help
	  UDP port to which native_sim publishes MotorOutput blobs.

config RDD2_SITL_THREAD_PRIORITY
	int "SITL transport thread priority"
	default 5
	help
	  Low-priority thread that handles non-blocking host UDP transport.

config RDD2_SITL_THREAD_STACK_SIZE
	int "SITL transport thread stack size"
	default 4096
	help
	  Stack size for the low-priority SITL transport thread.

endif
```

## src/Kconfig
```kconfig
# Copyright (c) 2023 CogniPilot Foundation
# SPDX-License-Identifier: Apache-2.0

rsource "main/Kconfig"
rsource "estimator/Kconfig"
rsource "multirotor_control/Kconfig"
rsource "rover_control/Kconfig"
rsource "sim_core/Kconfig"
rsource "sim_gz/Kconfig"
```

## src/estimator/Kconfig
```kconfig
# Copyright (c) 2023, CogniPilot Foundation
# SPDX-License-Identifier: Apache-2.0

config CEREBRI_ESTIMATOR
	bool "cerebri estimator"
	help
	  This option enables the estimator
```

## src/main/Kconfig
```kconfig
# Copyright (c) 2023, CogniPilot Foundation
# SPDX-License-Identifier: Apache-2.0

config CEREBRI_BANNER
	bool "enable cerebri banner"
	help
	  This option enables the cerebri banner
```

## src/multirotor_control/Kconfig
```kconfig
# Copyright (c) 2023, CogniPilot Foundation
# SPDX-License-Identifier: Apache-2.0

config CEREBRI_MULTIROTOR_CONTROL
	bool "multirotor control"
	help
	  This option enables multirotor control
```
