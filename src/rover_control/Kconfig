## src/rover_control/Kconfig
```kconfig
# Copyright (c) 2023, CogniPilot Foundation
# SPDX-License-Identifier: Apache-2.0

config CEREBRI_ROVER_CONTROL
	bool "rover control"
	help
	  This option enables rover control
```

## src/sim_core/Kconfig
```kconfig
# Copyright (c) 2023, CogniPilot Foundation
# SPDX-License-Identifier: Apache-2.0

config CEREBRI_SIM_CORE
	bool "sim core"
	help
	  This option enables sim core
```

## src/sim_gz/Kconfig
```kconfig
# Copyright (c) 2023, CogniPilot Foundation
# SPDX-License-Identifier: Apache-2.0

config CEREBRI_SIM_GZ
	bool "sim gz"
	help
	  This option enables gazebo simulation
```

## tests/drivers/flexio_uart/testcase.yaml
```yaml
# Copyright 2024 CogniPilot Foundation
# SPDX-License-Identifier: Apache-2.0

tests:
  drivers.flexio_uart:
    tags: drivers flexio uart
    platform_allow:
      - mr_vmu_tropic
      - mimxrt1064_evk
    harness: ztest
    integration_platforms:
      - mr_vmu_tropic
```
