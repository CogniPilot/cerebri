## CMakeLists.txt
```
# SPDX-License-Identifier: Apache-2.0
set(BOARD native_posix)

set(ZEPHYR_EXTRA_MODULES
    ${CMAKE_CURRENT_SOURCE_DIR}/../modules/zenoh-pico
    )
    
cmake_minimum_required(VERSION 3.20.0)
find_package(Zephyr REQUIRED HINTS $ENV{ZEPHYR_BASE})
project(tcp)

target_compile_definitions(app -fexceptions)

target_sources(app PRIVATE src/main.c)
set_property(TARGET app PROPERTY CXX_STANDARD 17)
```

## prj.conf
```kconfig
CONFIG_NETWORKING=y
CONFIG_NET_UDP=y
CONFIG_NET_TCP=y
CONFIG_NET_IPV6=n
CONFIG_NET_IPV4=y
CONFIG_ETH_NATIVE_POSIX_STARTUP_AUTOMATIC=n
CONFIG_NET_SOCKETS=y
#CONFIG_NET_DHCPV4=y
CONFIG_NET_SOCKETS_POSIX_NAMES=y
CONFIG_NET_MGMT=n

CONFIG_ENTROPY_GENERATOR=y
CONFIG_TEST_RANDOM_GENERATOR=y
CONFIG_INIT_STACKS=y

CONFIG_NET_LOG=y
CONFIG_LOG=y

CONFIG_NET_STATISTICS=y

CONFIG_NET_PKT_RX_COUNT=32
CONFIG_NET_PKT_TX_COUNT=32
CONFIG_NET_BUF_RX_COUNT=32
CONFIG_NET_BUF_TX_COUNT=32

CONFIG_NET_IF_UNICAST_IPV6_ADDR_COUNT=3
CONFIG_NET_IF_MCAST_IPV6_ADDR_COUNT=4
CONFIG_NET_MAX_CONTEXTS=10

##CONFIG_NET_SHELL=y

CONFIG_NET_CONFIG_SETTINGS=y
CONFIG_NET_CONFIG_NEED_IPV6=n
CONFIG_NET_CONFIG_NEED_IPV4=y
CONFIG_NET_CONFIG_MY_IPV6_ADDR="2001:db8::1"
CONFIG_NET_CONFIG_PEER_IPV6_ADDR="2001:db8::2"
CONFIG_NET_CONFIG_MY_IPV4_ADDR="192.0.2.1"
CONFIG_NET_CONFIG_PEER_IPV4_ADDR="192.0.2.2"

CONFIG_NET_L2_ETHERNET=y

CONFIG_ETH_NATIVE_POSIX=y
CONFIG_ETH_NATIVE_POSIX_RANDOM_MAC=y
#CONFIG_ETH_NATIVE_POSIX_MAC_ADDR="00:00:5e:00:53:2a"
CONFIG_NO_OPTIMIZATIONS=y

CONFIG_SYS_CLOCK_TICKS_PER_SEC=1000
CONFIG_NATIVE_POSIX_SLOWDOWN_TO_REAL_TIME=y

CONFIG_SHELL=y
CONFIG_CPLUSPLUS=y
#CONFIG_LIB_CPLUSPLUS=y
```

## src/main.c
```c
/*
 * Copyright (c) 2018 Intel Corporation
 *
 * SPDX-License-Identifier: Apache-2.0
 */

#include <zephyr/logging/log.h>
LOG_MODULE_REGISTER(net_native_posix_sample, LOG_LEVEL_DBG);

#include <zephyr/kernel.h>
#include <errno.h>

#include <zephyr/net/socket.h>
#include <zephyr/net/tftp.h>
#include <zephyr/irq.h>
#include <fcntl.h>


#include "zephyr/../../boards/posix/native_posix/hw_counter.h"
#include "zephyr/../../boards/posix/native_posix/hw_models_top.h"
#include "zephyr/../../boards/posix/native_posix/timer_model.h"


#include <stdio.h>
#define PEER_PORT 4000
#define STACK_SIZE 4096

K_THREAD_STACK_DEFINE(stack_recv, 4096);
K_THREAD_STACK_DEFINE(stack_send, 4096);

static int sock = 0;
static int client_file_descriptor = 0;
static struct k_thread th_recv, th_send;
static int message_count = 1000;

struct pollfd pollfds[1];

#define fatal(msg, ...) { \
		printf("Error: " msg "\n", ##__VA_ARGS__); \
		exit(1); \
	}

static void setblocking(int fd, bool val)
{
	int fl, res;

	fl = fcntl(fd, F_GETFL, 0);
	if (fl == -1) {
		fatal("fcntl(F_GETFL): %d", errno);
	}

	if (val) {
		fl &= ~O_NONBLOCK;
	} else {
		fl |= O_NONBLOCK;
	}

	res = fcntl(fd, F_SETFL, fl);
	if (fl == -1) {
		fatal("fcntl(F_SETFL): %d", errno);
	}
}

void tcp_connect(void) {
    struct sockaddr_in server_address;
    sock = socket(AF_INET, SOCK_STREAM, 0);
    if (sock < 0) {
        printf("\n Error while creating socket: %d\n", sock);
        exit(1);
    }

    server_address.sin_family = AF_INET;
    server_address.sin_port = htons(PEER_PORT);
    int ret = inet_pton(AF_INET, "192.0.2.2", &server_address.sin_addr);
    if (ret < 0) {
        printf("\nInvalid server address/ Address not found: %d\n", ret);
        exit(1);
    }

    // connecting to server
    client_file_descriptor = connect(
        sock, (struct sockaddr*)&server_address,
        sizeof(server_address));
    if (client_file_descriptor < 0) {
        printf("\nConnection failed\n");
        exit(1);
    }
    printf("\nConnected\n");

    pollfds[0].fd = sock;
    pollfds[0].events = POLLIN;

    setblocking(sock, false);
}

void tcp_send(void *id, void *unused, void *unused2) {
    char message[20] = { 0 };
    int i = 0;
    
    while (true) {
        snprintf(message, 20, "%10d hello", i);
        send(sock, message, strlen(message), 0);
        int64_t ticks = k_uptime_ticks();
        printf("send %3d: %10lld: %s\n", strlen(message), ticks, message);
        int res = poll(pollfds, 1, 1000000);
        if (res < 0) {
            printk("poll: %d", res);
            continue;
        }
        char buffer[1024] = { 0 };
        int n_read = recv(sock, buffer, 1024, MSG_DONTWAIT);
        int64_t sim_time = atoi(buffer);
        int64_t up_time = k_uptime_get();
        if (n_read > 1) {
            printf("recv %3d: zephyr %10lld: sim %10lld\n", n_read, up_time, sim_time);
        }
        if (i++ > message_count) break;
    }

    // closing the connected socket
    close(client_file_descriptor);
    printf("\nClosed\n");
    exit(0);
}

void tcp_recv(void *id, void *unused, void *unused2) {
    int i = 0;
    while (true) {
        int res = poll(pollfds, 1, -1);
        if (res < 0) {
            printk("poll: %d", res);
            //k_cpu_idle();
            continue;
        }
        char buffer[1024] = { 0 };
        int n_read = recv(sock, buffer, 1024, MSG_DONTWAIT);\
        int64_t ticks = k_uptime_ticks();
        if (n_read > 1) {
            printf("recv %3d: %10lld: %s\n", n_read, ticks, buffer);
        }
        if (i++ > message_count) break;
    }
}

void tcp_close() {
    // closing the connected socket
    close(client_file_descriptor);
    printf("\nClosed\n");
    exit(0);
}

void main() {
    printf("connecting\n");
    tcp_connect();
    printf("send thread\n");
    //tcp_send(NULL, NULL, NULL);

    k_thread_create(&th_send, &stack_send, STACK_SIZE, tcp_send, NULL, NULL, NULL, 1, 0, K_FOREVER);
    k_thread_name_set(&th_send, "tcp_send");

    //k_thread_create(&th_recv, &stack_recv, STACK_SIZE, tcp_recv, NULL, NULL, NULL, 1, 0, K_FOREVER);
    //k_thread_name_set(&th_recv, "tcp_recv");

    k_thread_start(&th_send);
    //k_thread_start(&th_recv);

    k_thread_join(&th_send, K_FOREVER);
    //k_thread_join(&th_recv, K_FOREVER);

    tcp_close();
    exit(0);
}
```
