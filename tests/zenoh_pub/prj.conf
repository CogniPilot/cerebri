## CMakeLists.txt
```
# SPDX-License-Identifier: Apache-2.0

if(CONFIG_ZENOH_PICO)

cmake_minimum_required(VERSION 3.20.0)


#set(CMAKE_MODULE_PATH "/usr/lib/x86_64-linux-gnu/cmake")
message(STATUS "CMAKE_MODULE_PATH: ${CMAKE_MODULE_PATH}")

#find_package(ignition-transport11 REQUIRED)

set(ZEPHYR_EXTRA_MODULES
    ${CMAKE_CURRENT_SOURCE_DIR}/../modules/zenoh-pico
    )

find_package(Zephyr REQUIRED HINTS $ENV{ZEPHYR_BASE})
project(zenoh_pub)

target_sources(app PRIVATE src/main.c)
target_compile_definitions(app PRIVATE ZENOH_ZEPHYR)

include(${ZEPHYR_BASE}/samples/net/common/common.cmake)

endif(CONFIG_ZENOH_PICO)
```

## prj.conf
```kconfig
# Kernel options
CONFIG_MAIN_STACK_SIZE=5120
CONFIG_HEAP_MEM_POOL_SIZE=150000

# Generic networking options
CONFIG_NETWORKING=y
CONFIG_NET_TCP=y
CONFIG_NET_UDP=y
CONFIG_NET_DHCPV4=n
CONFIG_NET_SHELL=y
CONFIG_DNS_RESOLVER=y

# Sockets
CONFIG_NET_SOCKETS=y
CONFIG_NET_SOCKETS_POLL_MAX=4

# Network buffers
CONFIG_NET_PKT_RX_COUNT=16
CONFIG_NET_PKT_TX_COUNT=16
CONFIG_NET_BUF_RX_COUNT=80
CONFIG_NET_BUF_TX_COUNT=80
CONFIG_NET_CONTEXT_NET_PKT_POOL=y

# Network address config
CONFIG_NET_CONFIG_SETTINGS=y
CONFIG_NET_CONFIG_NEED_IPV4=y
CONFIG_NET_IPV4_IGMP=y
CONFIG_NET_CONFIG_NEED_IPV6=y

# IP address options
CONFIG_NET_IF_UNICAST_IPV6_ADDR_COUNT=3
CONFIG_NET_IF_MCAST_IPV6_ADDR_COUNT=4
CONFIG_NET_MAX_CONTEXTS=10

# mbedTLS options
CONFIG_MBEDTLS_SSL_MAX_CONTENT_LEN=768

# Logging
CONFIG_NET_LOG=y
CONFIG_NET_STATISTICS=y

# IP Address
CONFIG_NET_CONFIG_MY_IPV6_ADDR="2001:db8::1"
CONFIG_NET_CONFIG_PEER_IPV6_ADDR="2001:db8::2"
CONFIG_NET_CONFIG_MY_IPV4_ADDR="192.0.2.1"
CONFIG_NET_CONFIG_PEER_IPV4_ADDR="192.0.2.2"

# Modules
CONFIG_ZENOH_PICO=y

# native posix
CONFIG_NET_L2_ETHERNET=y
CONFIG_ETH_NATIVE_POSIX=y
CONFIG_NO_OPTIMIZATIONS=y
CONFIG_ASAN=y
CONFIG_SYS_CLOCK_TICKS_PER_SEC=5000
```

## src/main.c
```c
#include <zephyr/logging/log.h>
#include <zephyr/kernel.h>
#include <errno.h>

#include <zephyr/net/net_core.h>
#include <zenoh-pico.h>
#include <stdio.h>
//#include <ignition/transport11/ignition/transport.hh>

#include <zephyr/logging/log.h>
LOG_MODULE_REGISTER(net_native_posix_sample, LOG_LEVEL_DBG);

#define CLIENT_OR_PEER 0  // 0: Client mode; 1: Peer mode
#if CLIENT_OR_PEER == 0
#define MODE "client"
#define PEER ""  // If empty, it will scout
#elif CLIENT_OR_PEER == 1
#define MODE "peer"
#define PEER "udp/224.0.0.225:7447#iface=zeth0"
#else
#error "Unknown Zenoh operation mode. Check CLIENT_OR_PEER value."
#endif

#define KEYEXPR "rt/demo/data"
#define VALUE "hello"

/* --------------- Structs -------------- */
struct Vector3
{
    double x;
    double y;
    double z;
};
struct Twist
{
    struct Vector3 linear;
    struct Vector3 angular;
};

/* -------- Serialize Functions --------- */
char *serialize_float_as_f64_little_endian(double val, char *buf)
{
    long long *c_val = (long long*)&val;
    for (int i = 0; i < sizeof(double); ++i, ++buf) {
       *buf = 0xFF & (*c_val >> (i * 8));
    }

    return buf;
}

char *serialize_vector3(struct Vector3 *v, char *buf)
{
    buf = serialize_float_as_f64_little_endian(v->x, buf);
    buf = serialize_float_as_f64_little_endian(v->y, buf);
    buf = serialize_float_as_f64_little_endian(v->z, buf);

    return buf;
}

void serialize_twist(struct Twist *t, char *buf)
{
    // Serialize Twist header for little endian
    *(buf++) = 0x00;
    *(buf++) = 0x01;
    *(buf++) = 0x00;
    *(buf++) = 0x00;
    buf = serialize_vector3(&t->linear, buf);
    buf = serialize_vector3(&t->angular, buf);
}

void main(void)
{
    printf("hello world!\n");

    // Initialize Zenoh Session and other parameters
    printf("creating zenoh!\n");
    z_owned_config_t config = z_config_default();
    zp_config_insert(z_loan(config), Z_CONFIG_MODE_KEY, z_string_make(MODE));
    if (strcmp(PEER, "") != 0) {
        zp_config_insert(z_loan(config), Z_CONFIG_PEER_KEY, z_string_make(PEER));
    }

    // Open Zenoh session
    printf("Opening Zenoh Session...");
    z_owned_session_t s = z_open(z_move(config));
    if (!z_check(s)) {
        printf("Unable to open session!\n");
        exit(-1);
    }
    printf("OK\n");

    // Start the receive and the session lease loop for zenoh-pico
    printf("Read task starting...\n");
    zp_start_read_task(z_loan(s), NULL);
    printf("done.\n");

    printf("Lease task starting...\n");
    zp_start_lease_task(z_loan(s), NULL);
    printf("done.\n");

    printf("Declaring publisher for '%s'...\n", KEYEXPR);
    z_owned_publisher_t pub = z_declare_publisher(z_loan(s), z_keyexpr(KEYEXPR), NULL);
    if (!z_check(pub)) {
        printf("Unable to declare publisher for key expression!\n");
        exit(-1);
    }
    printf("OK\n");

    double linear_x = 1;
    double linear_y = 2;

    // Create ROS twist message
    struct Twist measure;
    measure.linear.x = linear_x * -1;
    measure.linear.y = 0.0;
    measure.linear.z = 0.0;
    measure.angular.x = 0.0;
    measure.angular.y = 0.0;
    measure.angular.z = linear_y;

    uint8_t twist_serialized_size = 4 + sizeof(double) * 6;
    char buf[twist_serialized_size];
    serialize_twist(&measure, buf);
        
    for (int idx = 0; 1; ++idx) {
        if (idx >= 9999) idx = 0;
        if (z_publisher_put(z_publisher_loan(&pub), (const uint8_t *)buf, twist_serialized_size, NULL) < 0) {
            printk("Error while publishing data");
        }
        k_usleep(1000);
    }

    printf("Closing Zenoh Session...");
    z_undeclare_publisher(z_move(pub));

    // Stop the receive and the session lease loop for zenoh-pico
    zp_stop_read_task(z_loan(s));
    zp_stop_lease_task(z_loan(s));

    z_close(z_move(s));
    printf("OK!\n");
}
```
